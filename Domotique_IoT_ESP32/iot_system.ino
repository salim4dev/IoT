

// Importation des librairies
#include <WiFi.h>
#include <AsyncTCP.h>
#include <ESPAsyncWebServer.h>
#include <Adafruit_Sensor.h>
#include <DHT.h>
#include <Servo.h>
#include <HTTPClient.h>

//declaration de l'objet servo
Servo servo ;

//nom et mot de passe du point d'acces qui sera créer
const char* ssid     = "ESP32-Access-Point";
const char* password = "123456789";

//addresse ip du serveur sur lequel est hébrgée la base de données, dans notre cas c'est le pc (XAMPP: apache + Mysql)
 String serverName = "http://192.168.4.3/";
 
const char* PARAM_INPUT_1 = "output";
const char* PARAM_INPUT_2 = "state";


#define DHTPIN 13    // pin connecté au capteur de temperature et humidité
#define DHTTYPE    DHT11     // DHT 11
DHT dht(DHTPIN, DHTTYPE);


// definition des differents pins
const int cuisineLed = 2;
const int salonLed = 4;
const int chambreLed1 = 33;
const int garagepin = 19;
  const int ventilopin=25;

int gaspin = 16 ; 
int buzzerpin = 26;
int Ledrouge = 27 ;
String gazstate;


// Create AsyncWebServer object on port 80
// creer objet serveur web asynchrone
AsyncWebServer server(80);









//fonction qui lie et renvoie la temperature
String readDHTTemperature() {
  // Sensor readings may also be up to 2 seconds 'old' (its a very slow sensor)
  // Read temperature as Celsius (the default)
  float t = dht.readTemperature();
  // Read temperature as Fahrenheit (isFahrenheit = true)
  //float t = dht.readTemperature(true);
  // Check if any reads failed and exit early (to try again).
  if (isnan(t)) {    
    Serial.println("Failed to read from DHT sensor!");
    return "--";
  }
  else {
    Serial.println(t);
    return String(t);
  }
}

//fonction qui lie et renvoie l'humidite
String readDHTHumidity() {
  // Sensor readings may also be up to 2 seconds 'old' (its a very slow sensor)
  float h = dht.readHumidity();
  if (isnan(h)) {
    Serial.println("Failed to read from DHT sensor!");
    return "--";
  }
  else {
    Serial.println(h);
    return String(h);
  }
}


//fonction qui lie et renvoie l'etat du gaz
String readgazState(){
   if(digitalRead (gaspin)){
      gazstate = "pas de fuite";
    }
    else{
      gazstate = "fuite gaz!!";
    }
    Serial.print(gazstate);
    return gazstate;
  
  }












// variable index_html qui contient tout le code html, css et javascript
//on peut pas commenter à l'interieur parceque cette variale sera envoyé directement au client ,  et les 2 slaches// ne sont pas reconnus comme commentaire en html
//partie1:   style css
//partie2 :   different div,graphes, images en base64, boutons....
//partie3: script javascript contient:
//-------fonction togglecheckbox , qui envoi id et etat du bouton acctioné, au serveur esp32
//-------variable H pour le graphe humidite, et fonction pour demander la valeur de l'humidite au serveur esp32 , chaque 5 secondes
//--------fonction pour demander l'etat du gaz au serveur esp32 chaque 1.5 secondes
// -------variable T pour le graphe temperature, et fonction pour demander la valeur de temperature au serveur esp32, chaque 5 secondes



const char index_html[] PROGMEM = R"rawliteral(
<!DOCTYPE HTML><html>
<head>
  <title>ESP Web Server</title>
  <meta name="viewport" content="width=device-width, initial-scale=1">
  <link rel="icon" href="data:,">
  <script src="https://code.highcharts.com/highcharts.js"></script>
  <style>
   html {font-family: Arial;  text-align: center;}
    p {font-size: 1.0rem;}
    h4{margin:5px;padding:5px;} 
    body { background-color: #000; color:white;}
    
     .switch { position: relative;display: inline-block;width: 60px;height: 34px;}
.switch input { opacity: 0;width: 0;height: 0;}
.slider {position: absolute;cursor: pointer;top: 0;left: 0;right: 0;bottom: 0;background-color: #ccc;-webkit-transition: .4s;transition: .4s;}
.slider:before {position: absolute;content: "";height: 26px;width: 26px;left: 4px;bottom: 4px;background-color: white;-webkit-transition: .4s;transition: .4s;}
input:checked + .slider {background-color: #4FFC03;}
input:focus + .slider {box-shadow: 0 0 1px #2196F3;}
input:checked + .slider:before {-webkit-transform: translateX(26px);-ms-transform: translateX(26px);transform: translateX(26px);}

/* Rounded sliders */
.slider.round {border-radius: 34px;}
.slider.round:before {border-radius: 50%;}
   
   

.units { font-size: 1.2rem; }
    .dht-labels{font-size: 1.rem;vertical-align:middle;padding-bottom: 15px;}
    
    .welcome{ border-radius: 6px; width:auto;height:auto;padding:10px; border: 1px solid #000001; background-color:#051E57;position:absolute;top:0;left:500px;}
    .welcome_img{position:absolute; top:0; left:400px;}
      
   div.lampe  {position:float;display:inline-block; border-radius: 6px; float:left;  width: 140px;padding: 3px;margin: 3px;background-color:#000;}  
   div.ventilo_garage  {position:float;display:inline-block; border-radius: 6px;width: 150px;padding: 3px; margin: 3px; background-color:#000;} 
  
  .lampe_container{float:left; border-radius: 20px; position:absolute; top:430px; left:800px;
  padding: 10px; width:auto; height: auto; border: 1px solid #000001; margin: 10px; background-color:#000;  box-shadow:-3px -3px 5px #fff;}
  
    .vent_container{ border-radius: 20px; position:absolute;top:270px;left:1100px;  box-shadow:-3px -3px 5px #fff;
  width:180px;padding: 3px;border: 1px solid #fff; margin: 3px; background-color:#000;display:inline-block;float:left;}
  .garage_container{ border-radius: 20px; position:absolute;top:100px;left:1100px;  box-shadow:-3px -3px 5px #fff;
  width:180px;padding: 3px;border: 1px solid #fff; margin: 3px; background-color:#000;display:inline-block;float:left;}
  
  .gaz_container{ border-radius: 20px; position:absolute;top:420px;left:500px; box-shadow:-3px -3px 5px #fff;
  width:200px;padding: 10px;border: 1px solid #fff; margin: 10px; background-color:#000;display:inline-block;float:left;}
     
  .temp_div,.humd_div{display:inline-block; position: float;width:200px; height:80px;   border-radius: 20px; background-color:#000;margin:10px; }
  .container3{border-radius: 20px; position:absolute; top:130px; left:500px; box-shadow:-3px -3px 5px #fff;width:auto;height:auto; border: 1px solid #fff; background-color:#000; }
  .homediv{border-radius: 6px; position:absolute;top:120px;left:750px;width:400px; height:400px; }
  #chart-temperature{height:200px; width:400px;   position:absolute;top:130px;left:50px;}
  #chart-humidity{height:200px; width:400px;  position:absolute;top:360px;left:50px;  }
  


 
  
  
  </style>  
</head>
<body>

  <div class="welcome_img">
  <img src="data:image/png;base64,iVBORw0KGgoAAAANSUhEUgAAAEAAAABACAYAAACqaXHeAAAABHNCSVQICAgIfAhkiAAAAAlwSFlzAAAB2AAAAdgB+lymcgAAABl0RVh0U29mdHdhcmUAd3d3Lmlua3NjYXBlLm9yZ5vuPBoAAAvSSURBVHic7Zt7cFTXfcc/59679+6uHuwiaSUtWj0AEYMZ21CEH0mnDiHEth44HkOc2m0cu9P80Uw9kyFj05kGWWljPI3dJpPJtElt9xGPG9zgwkr4EWJnXDAJEmnJUNsgXpbQCwxCr13dXe09/WORvO+HHsh/8P1HV+f8zut7f+d3vuecu3ADN3ADnzpIKRr3d+5u8h/9QWurVHIt9t2Xjuxqe+lwQz5Nifx7t7DYtmePGnDW/ROSxwGQ/GzQKx47tmFDOFvZthcOn0QID0Ju+c7XP9uZS3s5s3s90OzvcgYcdftmBg8geKRiQB5o2XeoKGsFQtQCLqR4o+2f31uXS5ufGgIa23/vtoR8C2hMkb05ohgHm/1dpVmqmbr2dykKB3Mh4VNBQMu+33mlNH+N5LMZzDZayHeb/V3V6QwEfBjzb04kLDoBje3HVkeUyBEBt+RgvtpC/qZl37GUthL2JSRlJWFRCWjyd25EWu8CcW9VAJs85WwpL0ckh+nKiGL9+t59nUneYoX1HwNXE5IzkrBoBDS2d26WcBCIm9eqELR4q7hzaQkN7hIe8FahiaRuuhWFtxrbu+LixU1rKpYauq1AJjeXloRFIaCx/egjSA4AcZHdpihsr6pmbXExlS4bXrfOTUXFPOSrxq4kddWJlPsa93c+DvBu91iZr9z1i+D4iG34Uh/AWIJ9ShLU+R1adjT5jz4B4h8BLTa9UNN42FdDdYGTmlKdkiIbBYaCXVdQphRWFhbRPT6OaVmxxRQEzase/sbk3aWe753rGbrNDGMWFTi2IrRvW9Iak4hiAS6iK8QFhDTf2ffiu9MVXD8hJKVo9Hc9g+DJxCy3TeervmpK7To1pQZFjvj3Mj4Z4dylEFdMk//o7eFyKJRUfYN7KcqpIZZXl938yOb693PtVk4E7Dgrb1Gl9TVgE1B7Lfk88HZEKP/6/eXi95nKJ6m7GHjtDr7iq6ZY11juMXDoqWflZNji7JDJWCjCnr4eegOBJJvSSYsTdaqei2qcRkYCnvpIuuWU9RzwaAZbCbwkNGXH7hoxnJjZ7O9yWsg9pBA49YVFfNm7jEJdpa7czp/86thM3p4vbQCgrfcTl3/KKzg7ZBIIRfiv/j4+HBtN1Z+DqmU+sH/r5xJjQEqkDYI7TkuPDFuHga8DAeDvFUW5w1QUt6kobkVR7gD+AQgCj8kp69CO09ITW0cmdXfrEhcPVlWxxKGxssKOoWV3Rl0V1FcYFNtVHvAuY73LncosV9UIJASiWKjCeh1YDRwTEWX77lXibILJb4Hffrtb/khRrVeRrFNFxA/cDlF1NyXN11MJnDuXlrDJU06xQ6WmzEDJIxKpimB5uZ3ej03urajEpeu8fXEo0WxaNd7jb97Qk6m+tE0/ecb6JVguJaTe88xqcfne/cc2KcL6FnBHtKA8IoXyfEfThnd2fiBLLD1yAJTxZ1coX2hsP7Yaab1BosARgnvKK1jvcuMu1PAt1VMJnZwggb4rIS6PTXF85CoHBgawSFIAA6ql3LN/6x+kjVE5NX+fv3OXgF0p7CVStna0bGybTmjyd26U0EGCwNGEwlavl5uKivEssVHpsuXSdFZcHAkzcDVM9/gYr/X3EY5fJgGGLYvm17c2HE5VPisBzf6u+y3ka0BIIFsVy3oRICLUP0OwC7AJZEt780Z/Y3vnZiR7SRA4DkVlW5WPaqeTZUt1SopSz7zYgPcdXzQ8bX+zayZtOjAmjXB8it4rIfqCQX7e20MgEkk0CSDE9o6mDR2JGWljwDQsIYJIOSwlT3S0bPz3mKy/vW9/Z48Q/EAKNXRN3b0IxL1al03nIV81ZYaOr9TA5Zx/7eUu1FBVgbgEj9bW8UpvD8PxWmFaNX6jo6XhhdiMvGfgnc/85BAQPrLzzz8/ndbkP/qERDxPwqpSZhg85KvGbejUlRkUGJmV92w9YBoB0+LcJZOrZpifX+hhcHIy0UQixM6Opg3PTidk9YAUSJpkUih2ZPzZXY3TyYNV1RTrKss9BoYt+7ZjetCxyDboWDgNhZUVds4NwZ9W1/KLvgucmRiPNRFSSntcQs61Z0Fje9eTSLkb4KaiYrZ6vRTqGsvLDWzq9T16nIpIzl40GTcjtA/0cWI0KpgktB5obng61nZee9bk72y1oEjAt+az3rlCwvMKjLU3N7Qm5i3Iq2n0d6bYki8eOpob0o4zKQZ8c0fr3Q7N+bKhG5WWFRFXRoYJmkGklXpMUkpC4TAjExNYliU1TRus0xwUrFo9j0OYG5LWvhjERZ1v7mi9u9jpettuN7yWFRH9FwcIBANpBw9RdWfoOmVLlqAIIcLhcOWpnz5H8Nzp+er/giKOAIfmfFlVouL0ysgwVrKqSguhKBQXFgIgLYueV346n/1cMMRNAUM3Kqefg2Yw78oM2ycaKDB8edadSlwOY/XBfCOOAKFEg+JTf/WXc6r0/u2PIvPwnjq7wKnA/wVST7UT7/+OtWvWc7NTELDg3OT8xdjZCKF5RZ1d8FCpQAUsM0B5gTPJZvsKL/ZCwX0uQURKXuoLMohjXtpfVAJqDPhKqcB2bZHa5i1IaffgSu/MsyIEj3od/Ev//JCwqBcjRaqY1RvQFMHk1YuMT+R06pURi0rAiYDktcGJvMu98EEPhwauEIlMZTfOgkWPAaXO+DkftiSvdF/gVxc+RhHw+WWl/PGqKrSYoyOXbsNb4WNJccozwbywaASk2vkBvNJ9gY6PLlLuWYbbXcIZCf7+cb687JMzlm0rvWy79jzXJTKvKTBiTvHUkffZeeQDRsy5u18qvNP3MeWeZZSWeFAVFVVVOSNSB0eILpFzQc4EjIam+G7XSc6OBjgzOsGuzg8ZNnO+f8gZAoHbVRKXpi7g1ionAkbMKZ7uPEnPeBC74cBuOOifmORvuk7Nuyf8kbcEEk53bylcuPOErARMv/ne8SCGYae2ZiW1tfXYDQe948FZe0Jbr8X2N7t49XR/XPrDn6linW7iVKFIgbuKBXcXxxPw6ul+tr/ZFXdcNltkDIKjoSnarr15w7BTV1OPpkX1fm1tPefPd9M/EeTpzpPsavgMbiO/o+61a9bjSHi7mhDc7838PdSwGcZTVomnrDKjXS5I6wGZBg+gqdqMJ/RPTPJ058m8PeFmZ1Te5ovH11SzsTT7R2O5IC0BRwavzMz5uppVcYOfhqZq1NZ8QsLRoaS70YwYj0jCMv8IF7EkPReHGBnNr71USDsFvlTtQQjBoaklaFr6maJpURI+p42wxVeWV+MfmfBv/QG+VulAUwQvfNCDW7fFaX+A/zzdz3AozOOrq5myJM/+z2lODI9TU+hJU3PuyBgDtvjK+E0OQkPTtLwHP40BGd3YBIcvcnjwCt4KHw8m2Ow504+nrJKf9Yzx0cdD0cH7VlBYMPdpsOhSGGAQB+P6UnzLitPKW09ZJeeBEXuYGp9nXgYPC0zAFsf3OR5qYSiyKqtt7IDaeq20Ci8X/V+hnuJW234sBMfDLRltF5QAO2Os0/cipUoEG8dDLVyyludUdu2a9Xm1Vaac4VZ9PwpTKCKCTvRI7zabP2O5rASk27TkCp3gzO3DOmMvbwV3zKm+dFin78Uuotdgp07/LwhYteI27GIkY7nrch5w5vwJIOoRX7Q/h0ftnre6y9VTbLE/h5wcIhi8drYgonuKXHBdCFhRu3bm2SFGs7plPrjF5scu4j+WWrXiNupX3JpT+QWNAWJiZ8p0B7CVpKvr2SHwFwDMHKukOGB6r3tnnNq6q75gxj0W/WvxxcYNAha7A4uNuBggLaRQELu/90N6+nszXoqmgiUlQ5ejV2JKDt+/Hfzv43nVn4jNf5hboMuEOA8ITYUGp58dhj3ZOgvMmA+TSkpmtze43ojzgMnw5GM2VTugqIpwFbuZNM2cb4gtaTE6Ef2AWQghJ4MTt99VX5Dxp2ttL743p9O+2Gg+W8R5wA//7q/fuDw2silomn2qqkqvp5ICpxMl+ccKM5BSEjRNLg2PIKUlDZutt9DpvH3vyz/O6Xd7N3ADN7Co+H9YIDXb84hOjAAAAABJRU5ErkJggg==">
 </div>
 <div class="welcome">
 <h2 style="float:left;text-align:center;">Smart Home Control Panel</h2> </div>

                  <div id="chart-temperature" class="container"></div>
                  <div id="chart-humidity" class="container"></div>
  
 
<div class="container3">
  <img src="data:image/png;base64,iVBORw0KGgoAAAANSUhEUgAAADAAAAAwCAYAAABXAvmHAAAABmJLR0QA/wD/AP+gvaeTAAACD0lEQVRoge2ZsW4TQRRFz8y6QSKOkja4QSGiIWmwTQEGsjKUIIogUYeKH+AnUFokxAeEihpkE8cFsKJASQNiJYooHXIk43JnH00kSBR5jd8sFtKczp69787V27c7siEQUGHKKLqfpjWXyZZg7hx/1bHYp2uXL3717eU9wH6a1rJMPoNZPLV0VKmwdmV5+cCnn/VZDMBlsnXG5gEWssw88+3nPcAft81Zq3d9+3kPAMyNWav6NisjwD+lUrZB79NeqfVDB4q4eXW11PqhA0WEGSggzMCs8d6BS08enfi8dzj0bXGC0IEiVpdOHX+++K0fOlBEmIECwgzMmjADs+a/nwFvvwsN48aKhRdAa+yFQs9F5vH824/ffPh6CfBzvd4y1rxGWJjQ9SgX7lU7SV/rrQ4wjBsr1vBh4s3/ZuBc1JzfeZ9q/NVDbOH5FJsHWIwi99KD//SM4mYbuK0o0Rq167FmD8oOyEOdHiRnQ6PX3kLXlXqM2PFPrQJUAQwsafQAxsgFjX7mb2KBXKNXBRA41OiPUdXQBlC/iAR2NXrdDBjZ1ugBEF6p9qD1H8WNDrA+lVjone8mtzT+6iGOIjaBH1NIBy6PNrX+6gDn3iTfc3gADP5CNsjhvvYcBJ4eo9VO0nfWXAPZmeDyd85FTR8nUSjhf+JRux5LzobB3DBQAxA4EKSPmO25btL17RkIKPgFSbmNfS29ao8AAAAASUVORK5CYII"> 
<div class="temp_div">
<p> <i class="fas fa-thermometer-half" style="color:#059e8a;"></i> 
    <span class="dht-labels">Temperature:</span> 
    <span id="temperature">%TEMPERATURE%</span>
    <sup class="units">&deg;C</sup>
  </p> </div> <br>
  
  <img src="data:image/png;base64,iVBORw0KGgoAAAANSUhEUgAAACgAAAAoCAYAAACM/rhtAAAABmJLR0QA/wD/AP+gvaeTAAAD+0lEQVRYhe2YW2gcVRjHf9/sbpLdZJtNMSoJ2sYKNV6C0Ggt2gYxQgxS7yj4UBuTqpGAAX0xgqHi7UFRSAOaRkWoSB/UYoyVikVEoXYFS6mC1cReUqyBzWXZS5Ld+XxIsmyS2eyctfui/cF5+ea/8/04M+ecYeEi/3HETSgcDvu85aGdiNyswhkhtffGjRvHii0HLgTD4bDPUxH6BrgtqzzpUdnWUL/hePHU5rHyBbzloZ0slQMIpS37jeIoLSWvoFpscb4gznUDeg+rd9ehSOVqmbyCqJTnuFJRiFQ2Z+PJHnu27L3VMl6TG0Zjcc78Nf7vrBZoH4ptAu0BfB1D8UcG7g587JTLP4NZJGfnGJ+YyoyCURVE3gZ8ACq81XZAg05RoxmsrqqkqbGhcLEF2r9MPADcmlW6zPIlnwFeWp41msGZCzSDqtK2sqYramA4g9OxOL/8capQrwwWWqbLagJ+p6yR4JryANduWFew2CI2+pEgt2fXFPY5ZY0ecWmJj+qqyswolMHWwCDCs8Ap4LzCmwHxP++UzXvU1fVH9wMPAcycGyN69EjmWvSrHa7O8l1h9b3bKHNusssxmkGP309pTW1muOHJz+O19t+Jb7v3q+M7dkEFvVVrCd60OTPyoiopS99H2TJdnni16IKpiQjRo0cyIx/tXyQfBbkTQKBr/vQww2gVpxMJZs65+wzsGtbShCZezipZIK8DzSY9zVZxTS2X3HN/ZqxG3E5sB65cUhTuaB+aqTfpaTaDyQSpSMRV1hJqlm/GAILWAr+67WkkmIpEXL17AHjSX5P2zLHwQbDAeNwq/dGkp9kqXut+FQ+0BE+g0gayeGifVuTBfa0ybdJz1Y123Z5ovSUyDLreMaCyY/Tpig9Xu0fvYfWeTSQu33uXfwwRp6demOD6/qlbBOsQeb6cBXaPdAZfNG0M0DGUbLYt+5rB1kCfkeBV70QqNe07Dlzhoo+K6PaRp9YMmcg99ulEyFtSegy4VDzpxoGW4AmnnOM7qHZJu0s5AFGVXhM5AF9J2WvMb0NlmvbsyZVzXiRqP2zYb1NdX8L1d1jHweh1irZnlZoeH47d65TNsYrlaiM9QEi7/o2mrW7As+T3Ks85ZXNtM74c9ZzYHvd7qiLXO5RvcMo6Corwm9tmi9iaOuk2a8EPDl2/z5Fdidp84rbZAj+f7gyNuA3Pzc7sJktS4aR6pMu1oHjn+lDOu20o2C+4zQJ8cF/V5FTMv01tNivSlA74GwZbyn53vncO6vqnt4IcBAJ5+r0y2hnsMRE0IedZPNq55jvbtrYCx3JEJoAniikHbv7A7FWrrjrWjNCMag0woehPzKY/+7O7arKYchf5X/APFP9PCw2RAl4AAAAASUVORK5CYII">
  <div class="humd_div">
  <p>
    <i class="fas fa-tint" style="color:#00add6;"></i> 
    <span class="dht-labels">Humidite:</span>
    <span id="humidity">%HUMIDITY%</span>
    <sup class="units">&percnt;</sup>
  </p> </div> </div>
  




 <div class="homediv">
  <img src=" data:image/jpeg;base64,/9j/4AAQSkZJRgABAQEAYABgAAD/7AARRHVja3kAAQAEAAAAVQAA/9sAQwACAQECAQECAgICAgICAgMFAwMDAwMGBAQDBQcGBwcHBgcHCAkLCQgICggHBwoNCgoLDAwMDAcJDg8NDA4LDAwM/9sAQwECAgIDAwMGAwMGDAgHCAwMDAwMDAwMDAwMDAwMDAwMDAwMDAwMDAwMDAwMDAwMDAwMDAwMDAwMDAwMDAwMDAwM/8AAEQgA+gD6AwEiAAIRAQMRAf/EAB8AAAEFAQEBAQEBAAAAAAAAAAABAgMEBQYHCAkKC//EALUQAAIBAwMCBAMFBQQEAAABfQECAwAEEQUSITFBBhNRYQcicRQygZGhCCNCscEVUtHwJDNicoIJChYXGBkaJSYnKCkqNDU2Nzg5OkNERUZHSElKU1RVVldYWVpjZGVmZ2hpanN0dXZ3eHl6g4SFhoeIiYqSk5SVlpeYmZqio6Slpqeoqaqys7S1tre4ubrCw8TFxsfIycrS09TV1tfY2drh4uPk5ebn6Onq8fLz9PX29/j5+v/EAB8BAAMBAQEBAQEBAQEAAAAAAAABAgMEBQYHCAkKC//EALURAAIBAgQEAwQHBQQEAAECdwABAgMRBAUhMQYSQVEHYXETIjKBCBRCkaGxwQkjM1LwFWJy0QoWJDThJfEXGBkaJicoKSo1Njc4OTpDREVGR0hJSlNUVVZXWFlaY2RlZmdoaWpzdHV2d3h5eoKDhIWGh4iJipKTlJWWl5iZmqKjpKWmp6ipqrKztLW2t7i5usLDxMXGx8jJytLT1NXW19jZ2uLj5OXm5+jp6vLz9PX29/j5+v/aAAwDAQACEQMRAD8A/H94QSflwPSm+ThfU+uauPBtOD2465FMNuSM8Ht15r+gbH5SqhS8rHUZHfHeo2iBq8YSzAdycDP+NRvDmlymkahTeHA/rULRDPK59avPBgZ4xnHWozFubbjk+9Tys1jUKLQ4+7UbID1HOavPBUckPH6e9TY3jUKLRbf/ANdQtFn/AOvV5oDu4qFkDCpaNo1CnJHjtULRCr0kW0f54qFos9KnlOiMyi8eP89Khkix/nrV54s1DJFiszojUKRXH+FJVh4c/hULJj/PWpaOmMrjaDR0NFSWFFFFABRRRQAUUUUAFFFHSgAooooAKKKKACiiigD1MxUxoM1dkiyemB6dhTGi+X7v4+leryn57GqUmiI+lRmL/Iq95eGB+97VG0WamxtGoUmix/8AWqNos1eeHC9O/X1/pURT5vmXd/WlY2jUKLQbelRPH61eeL/IqN4wV/qO9Tym0ahQkhwahkiz/jV9odh6fgaheLdUcp0RqFB49nUVFJFV6WLj7o/xqFo9p/zxUuJ0RqFJ4t3+FQPHj/PSrzx7qhkT/DPrUHRGZRkiqCSPPtV+SPHbNQyRcVDVjqjUM9o8f56U0jBq1ImT/nmq8i7T/L2qHE6oyuNoo6UVJoFFFFABRRRQAUUUUAFFFFABRRRQAUUUUAezPb7WI/u+hzTTD8ueODjrz+VXDDio2jx/9eva5T8vjUKfkb2xxz68VG0VXXhzUbxYFS0aRqFJoeO3XpUZg3Nt/nVx481G8XFTym0ahSeHionh+XPHPHX+dXmj4qJ4t1TY6Y1Ci0OT/j0qKSHdV14sVDJF/wDqqbHTGoUpIsAZxz6VC8HP+Jq88e6o0spJg5Vfkj+8xOFTgkAk8AnBwOpxgZPFTy3dkdEaltWZksNNe1IQM+FDDj369vw/UVpSCO2P7vErKeHK/Lweqqfp/F2JG0VSmj8w5JJb1JqXFLc6KdRspyp94L8q+55NVZYsVeZMDmoZI8fSsmdcJFGWL/Iqu8ef89avSxYqGWKoaOqEyg6Y/wA9KZ0q1JHk/wCFV2TFZtHXGVxtFGeaKk0CiiigAooooAKKKKACiiigAooooA94kGWOVx346U3aNuB65rYZbe+l2zeXaSM2PPijPknLHLPGBlQM9YhgKgAiJJNVb3SJLSKOSRV2Tf6t1IdJPlDHawypK7lDLnKk4YA5A+ilT6rVf1v/AF6XPx+FZPR6P+tv69bGd5e1s4BxzjqD+FRNF/8ArFXPIJdRuwCcEntUbJk+9ZNHRGZTePK4wOucgVGYtp6A47HoavPBkZ757DmoTDlhzgNxk9KjlNo1Ci0WRUbplcY79auPFmopI9q5JHXGO4//AF1LRvGZSZMHsfqKjWzkuZvLijeSTazhUUs21VLMceiqCSewBJ4FbUujR6XcMuotJHJExV7OMgXAKthkckEQtw4wwZ1YLmLad1Ubi9kmtvJVY4bdtpaKEFVdlHDNklmOckbmO0swXaDiqlT5fj+7r/wPz8ma06/N8P39P+D+XmVZba3sZP33l3cyEgxxv+5yGHDSKfnBww/dkDBVlkPIqlcTyTbRI25YxhV2hVT1wowBnGTgcnk5NW5YePr+lQPHk9dvuazlK+i0X9b9/wCrWOym+r1f9bf195Qki25/lUMke4f55q5cFYfvHbnt6/SqxlRj8rdexGK4amKoRn7KU0pdm1f7j0qdOpKPOou3ezsVJI+DwOmOe1V2StCWLPfH1711nw9+A2sfEC3jvnVNK0XLZ1C6yqSBP9YIl+9Ky9CEBCllDFQwNa8rehniMwoYWn7XESUY+f5Lu/JannskfPT8hWx4S+E/iPx+jSaPot9e26P5clysRFvC3HDynCJ95R8xHLKOrAH6O8F/Cnw/4OIt9L0yxvrhTiTU9YtY7hvu5cmGQtCiomG2YaRZH2+ZIAM63xD17/hDLy3j8UXl5NqfzQ2mkpO0l2zgErb+YVZYSqtgbwZBLcB/LcEmr+r9ZHx+I47lOp7DAUrye3Nu7deRa283JW+0keN+Ef2M7zVbyOPVtctYJXDE2ulQ/wBpXC4yN2QyQMmQRuSZsYJxtBYaV+vwt+D5t49L0W18Za5cM8UNxqV8bnS7e4UAFTJEYUkGSoxtMYEqy+cc7IsDx58Z7/4h6YtjDNDo/h3UBGkUcDiMQXEOCguJODKvQhnOxBJuXBR0ri7sJItxJeI1vDeSrb6ojRlXs7tdxWYJjjJ8wlQMj9+gVAUNQ3GPwo7sPgsyxb580ryS/wCfcHyr0bjZvXTlu1dWu1LXd8X38nxz0ae6ls7Gy8Q6fuMdvaWUdjFtVS0tsIo1WNcKrzRAKhOLmP52WEHyuu3tdSutB1NtS3TwX2nskeoNby7ZnXepiu4pFON4cRkSA4LiJ8v5jCovir4ZhYR+INPjt47HUHCXMNsgWG0nKlgVUAbIplBkjUhdoEkWCYHJ5566n1eV1I4Wawq0py+G2yf8q8mtY/ndpLjaKKKyPowooooAKKKKACiiigAooooA+lLXS5LwbvljhVgrzSHEcecdTyTgHO1QWwDgGuk+HXhWz8RSahH/AG9pHh+OO3DSXWr/ADR3DkBVjSAB9zAtJh2VwuFceU2Kw7+5l1CbfIw+XIVUG1IwWLbVUcAZY4A4GarMnybcLjOc4/z619TCUISulf8Ary2/PzPw2XNONm/8v+D89PIR7G31SX9wFs5nbAhZz5JJfACOxJUDKjEhIAVmMnas65tGhfZIjK2A21hg4IBBx6EEEHuCDV/ZtYNwdvPTNOW7ZbfyZFWeEA7Ff+AkYypHI52kgddoB4rN2e+n9f1t9x0RlKO2q/H+vX7zGMRX3pjLmt9fD/8Aaku2xkV49+SJSFkhVnCAsQPmAymSB1Y4HFUjLb2QDQxrcS7f9bKnyrlcEBDxkEkZOeVBGKUqNtXt/W39etjeOIUtI7/1v/Xpcpw6PlY5bqT7Jbvhg23fJIuQMxpkbuNxBJVDtI3A1C2otapts4zZ7kKvIH3TtlCrjzMDapDONqBQyttffjNSXcsl1cySTO0kkzl3djksxOST7kkmoZEyuOwyRx0rNyt8Onn1/wCB8vnc6Y6/Hr5dP+D8/lYz2h2KFUAKowABxUUkeavsvl88d+oyKryRnHyj8TXDicRSw8Oeq7L+tu56GHjOpLlgrlGRdo9Kz7282K235doyWbsP8+tReI/Fdtp12LWMSX18x8tbeHltxOACRwDnjABPTitbRfhBeahq1vH4qa5hvLja8HhrTmP9qXKk45VUlaI8P96OSRTGd0aqd1eTCOPzHSh+6p/zP4n6L9fufQ+gVPDYGCq4x3e6j3t2XXzbtFdbLU5rSLK88Yav9j0m2kv7naXcrwkSAgNI7nCpGuRudiFUck45ru9I/ZV8XeIbho9JuND1a5hhjmubZLo2rWqvgDc9wsUbfOwQFGYMxGwsDur1rw18I4NCsRaazJHplnCwl/sLQm8pG2LuMtxKkks+/DKdrTE5lMR8gqUX0V/Dk1vbW1vJDY+GdMZU8m2jkSxg8xo1jlw7MFaRYwsRaeYyMzMxLlSR9Dl/DuAw0HBU1JvdySk363/JJI/P898SsR7RLAtRj0urp7dmnKy/kdlvzySseXeBv2fNN8APDNd2reKdYwskG+B1sPmz5eyKRVaYsy7gZNqGNZAYmyrDs9UmtbO3j1HWtQtzAwxEJHXF3FFkhIowd0waRcGOMfu18td6ZUGl4r+NsPg+e40vwxbpcaltleO5e3YWnmLlGgELCPdIioFVbk43Iy+Q/nK9eceJvF0fjOWC98RXSzrqRE2m3kjsbuCZFVAiyIUXaAqor7nUAQ7nHlso1qZTOlH/AGPVfyyf5S1a9HdecUfOUqOOzSqsRmDaT6/bt5Q0UVpe6s9HeMmXtf8A2irzUNTsLPwu8+lQXTKLPVHIW9eZZFaSPIJW3Lttb5CZAXj3zGNjjydr5XWb/Vx6fqr7ZonXMNjdDO3cO0TckccKW2h3gBre1Kyszq1vcxW7WekapPGtxGRn+zLoOwViFUEKQGO3aCFMqBWMaucS/kP2i8mvY5Cwb7PrEKbZJD83y3KnPLbsZbOC+NzkT7a8n2/NN053jJbxas1527PurrzPv8ty2hhIWoQsna73bafV9ZJ/K9rWjMZdpBqzXk1zutZ5pfs2r20nKwTgkLcoWP39wckE9RKpdBMq1m6hbT6Xc3H2yAvdWcS2+oxA7Re2jbPKmQ4wePKIbGD+4kAf52q1Mslk7CZY7q50+FYbmJHIj1CyKrsYEjPyqUIOMhfKcIDEzVJDqE1mkNt+71D7BE09gZU2rdWjbvNi4PBGZdy5Kk+cjFyEWhnr0247ar7u2z7Wtv0s73gzHaOSzkDRtHdXWnQNNBI6kR6lYlTvUgHPyqXyM7lTzFLKYlWtDwhqVrYztpNwt1eaHq8JWEAK9xLEWyYF+7ieOUb4wCoaVCu1o7liXR6D/aTWseizSyPJJ9q0cNhri3mBBa1JA+dgQNpAyWCPsiWZjWMVt7+0TY0dvY6g++Jy2I9Mu8AkAn7sTjbznGwoS0jQEVm9GdXuVouD/wCCnq07bpp3ats+ZL7JheLvC83g7X5rGaSKdVCyQzxEmO5idQ8cqZAO10ZWG4BgGGQDkDNzXpUtk/xP8Ktp80UkfiDSpHW2jZNsjzEs8toEPTzW8yWNFxiYXEYjzPHjh/Celrq+tRwSfKGYA5rnryjTi5vZanuZbi5VounU+OOj8+0l5P7r3SbtczfwP5UZr7Kf9gTTV/ZkXx9/wlHgj5pvI/sUa5D/AG4Pm2eYbP74jzzn723D7dnzV8j+K9MXSdamhRgyqxHFfLcO8YZfnUqsMDK7pScZabSW6+R7NfCzpW5+upm0UUV9Sc4UUUUAFFTR2nyq8reTG2CCV3MwyPur34OecA4POaFktto3Q3Oe+Jl/+IrT2ffQnm7an01Jb7XIDZweo71G0WF5I3ZAxzmrph49qidK+isfg8ahT8jcw+bbk8n0qJ4s1daGoXT1pG8ahVCtA6yxuyyI25SpIZCOhB9c/jxTmlhvV23Ee1guBNGORhcKGXoRwo4wQNx+Y1I8WKjW1a4fZGrMzfwgf5wPc4pOpyq7289jePvPzKuo6S1onmKyzW7MUSePlG5OB6qSBna2GAIJAzVVLFph8nzckHPG36n+gya6C30xtLDSyTGMsux1RiFZchtrH+IZCnHTI78VxvjL4iLYK1vp6ruA2+ZtGF+g6D9foK4PaVsS+XBQ9ZP4V/n6b+TPYwOFnUfLLX+uv/AJNf1Sx8L23mXk3zMMrGBl3/3V/qeAe4rEh0PWfHltHc3VwPC/h+YFklZXmvb5ASCYYYwZZR8rLuULErDZJKpIzL8PPEei+HtA1rxFruinxBfQ3tpaWxnmBig85LovI0bKyzEeSoCvxgt3KslzU/Hvh/xtdSzT+KrrzpG3THW7KXFyxAG0RW7MjLgD5p3YrhRhhlhth8jpU5+1rv2k+72Xov68rHsSr16M5UcPTaUdHNR5tWk/dik9rrWS3vaL3O++HnwRtfBmkR3jXlt8PdNmjDDU9Sug2vX6kcTW1vbt5yw4LA+XJECkhVvtDLGrbum/F3wT8NdMksfCen3jW8ruk0lsq2iXLY2kPIFJkX7oeExqh2Rgg7WeXgNGs9R1HQ10n+zbPxho8SlVtLWeHUpNORsnchheOC1lBOQo8xZGGSsqx8T3/wAI7nW9O0JvD80etWWoWrPFpl0hkkhHmzAGIsqxzjbE/wA9rCZWijd/LQEV68dz4vFYOjXqt5pXck30dobNpyd3K9lpzSUVa0baosax+1RrV1bKnhyGz0K1gVWW4s4/NuQEJfcszMUt3VsyZSQned2ThFHKeLLm8127W+1S4uLpGt7d5Lm6fzg6mJQrK0m2HcNrLhA7HDgZ+as3UPEuk6fc50ll1LVIyHi89/OEcmQd0UjfK2eflRUJJTa2VAPK3fjDUtTuHW/ka6QOzG3uNzKjn7xHO5WyBkghm24Ynmt4H1WX5HRpS58LSVPu2vfd7bvd7aNu3bRI9avfHFv8QfCrTW5t5NX0kRre390d6ocrFFdxBwFRWPlwysVjOTbSkM6sBx93fNqc11dak0y/b5hDq3mq3m212NxWfaecn5yV6/69AEBQ1neAriTTPEdvqGktC00AYS2t6fkkiZTG6MRt8xJFYoVXa7eYVUHrXZ+L/D1jpVp/a2n/AGq+0+VVgm81grT2xJQxt8o/fQOiIWZUyRBKIiG3HrgYujSwVb2ENpbd0/5ddFteNtNFZWjJuO1uJrLVbGeZWaaGOO21REYE3ETTYSdW+6Tu2fMcqW8pj5nmMKhuLCO5nbHk/brGLBxnydVsiv8A32m2P0yyJ2jMFS2sbWesaX5TR3FzYQJLDK6kR6hZndvBAOcqpbIzkL5illMSrSfYprS+jtrfzkmjcz6XJKoaU/N81sykfe3ZwpXBfO1CJw1Risvw+LhyV43ts9mn3TWqfo9euhlSrSpyvB2uvk1run0t9y84GLdaZPps0FvCxaa3Q3OlOyg/aoGZi8DLyrc7/lHylvOT955i1RFusn2eOzkaGO6kNzpciuQ1pcjbugL/AF2AMcH/AFLkoGcV1UVtBqNpHDE32WzvpDNZOJCv2C6G0Mm4nhT8g3E5x5TFsoy1j65pCQW00t1H9m0+9kEV8VhI/s66UMVkKKMqp+c7QvCmZFUFUavlMdlOKwV5xvVp90vfivNLSXrGz/u9T1cPiqdV2+GX4N+XZ76O6b5le0kYVxFb31o+9Y7ax1B9kibNqaZd4OCQBlYmG7jGNhcBZGgBqzd6qmpSXcmtwzM8sn2bV2jANxbzAkLc7SQJGzuLchi+9TJGkwUuvVdDcT3sbseLfV4oisjyDI23SsDgtu25bOGcLudhOVqGPT7ppZF8qO8uNMgWO5RX2w39iVXY+5hxtUpgkAhfKYKpiZq8+nWhVjz03df1+Pl0OyUbfHpbz222f3Wez9yT+0RzWl5oMzX8bLdy6WqQ3r2spUXNsdnlTK2Mqw/dlHKjO2GRVcrI1N+JGl70h8Wab5ZiupFjvvLTy1+0sGcTIoyqpMEdtgI8uSO4jCqsS5sxzR+GZYRYzLqOoWcL3FhNImLe8tWLF4WTOJMYfcrHaSJ4j5vyA7vhrRIdFvNQuNQaGx8E6gZoRPdOR+6Mo860jwC8sqOkTKVRxHKlvK6RxSuTUqakuV7GcsW6E411utF0cl/Ko736xSs7px+zZ8kfjtrR0j7H9ok8nG3Ga4+9u3vrlpJG3Mxzn1plwsaXEiwszRKxCMy7WK9iRk4Ptk49TTa8zDYHD4dt0YKN97H2zqOSuwop9tbSX13DbwRyTXFxIsUUUaF3ldjhVVRySTwAOTU/2a3s4t08y3EjLlYreQMq5Q4LSDK8Eodq7s4ZWKEV3Rg3r079P68lqZSqJade39fnsRWdlJfPhAoVcb3Y7UjBZVyx7AFlz6Zp/mw26fu/30jDl3XCplSOB689T0Kgim3t/JfN822OJWLJFGNscec9B7Zxk5bAGSahq3KMfg+9/p/V/QSjKXxfd/X9eo6WVp5WkdizuSWY9yTk02iism76s022PrSVDI5Y/eJyTUTqQhX+FiCeO/P+NXZYF3ELkjPBIwajeMBerbs8DHbnv+VfU8p/PEahRMbRsGXqpBB9MVC8W44xkk4x3JPpXQaR4QutZCyKPItz/wAtnHDD/ZXq36Drzmu+8H/Bljpn9pSNDpWlfdbVb7P7z1WFQN0rdfljGDtwxBGaziqlWfsqEXKXZf1/XVoWIzChh4c9eSS2+fbzb6JXfZHmVj4QmmVTdM0MechAAZGJx+WeOuT2wOtX9ZsbfwdZAXQ+yMwDLbKN1w/oWB5H1c54xXYeKfFVl4biaDw/BLG/KvqV2A11J67FHywqeemWwRls15F4lnaaaRmZpHdizMzEsxPUk9Sa9rD8Mp/vMe+Z/wAq2Xq+vy+9o6svxVTFO8Fyx8/ify6fO78os53xr4pn1Ysi/wCjwdBGpzn6nv8AoPauA1Zsufxrr9WsZps7Ub8q5HXLSSEkspFdVaUIrkhZJbJbL0R+kZXRUIpJHT/BrwpZ+OtC1DTdQ+0fY5tStpHFvII5D5dlqcgAYqwGSg6qeKzPG/7NOpDzbvwvI3iCwCmR4Amy9tEwpzJHkhlCtkvGWVVG5/LyBXR/sxtY315qOnz6hbWt7NKJbaCSQRNd4sdQi2ozYXeXuIlC5LsXARHwQO01K8vLPUpbdVm0yRJtpiUGOSGQNxu/i3I044P3SpAxkV5dQ8bHZvjMHm1SOHlpaL5ZL3XpZvo+lrxa1Wt7WPmHFrpB+fF3ddAgYrDH67iMFj1+6QvQ7mGRXoHxJ8d614p8DeGbjUdVvryeTS1iZ5ZizFPt1+dv+6SqkgcEqp6gEd94t8GaF8UT5mrWzWepS4K6nYxr5xztI86PKpNzLy5KyErlpGGFHBfGPwnN4G0TQdJnmhuHs9PixLDu8uVWu791YbgGwVZT8wBGcEA1lFWPfpZthsfVoqUbVYyvZ66crT5Xta9r7Pa62KCfEG18Y/u/FlvNeTtwNYt8f2gh9ZckLcgZJw5WRiEAmRRtNzU/CVxZ6Q17G0PiLQ4tq/brVj5lnkhUWUEb4ct8oWRdrlX8st9+uf8ACngLUvFVvLcQxxwWFuwWa8uZFgtojjO3exALkZYRrl2CnarYr1Dwl4D0T4PXlvqmueJtWW+xmDTtGgMNzfI4xt3TAPCpVlJ86ALIj/J5o3AdMDPMsRh8JLkw8ve/59pOV32XLrB+ekUrtrdrhdL0vdpuoTW0n2iIW43YXbJHiRMll5wPcEjkZIPFd38H/FI1LTZtD1Rlks5riI21zM2F06UxypudunkOuIpd2QIznBMarWrr9h4N8R6aNctYrrwr9uItXWOQXEdlOGDgXIijBhaQIzq0USqSrRpbqInlPI+KbK/0ww22q2osbe4PnQXFkyy2t0V4MgZWKTEElS6uSpLgkkFa6oankVMVDH0nRqRcZN9bXTVr2tpK1teVtNb3T16bVbBPDPiOHT7VbptQ0+b/AIljTLsayuonAktnwctIHAABxiRY2wEmYltlqWn+IbKMSiO2s7wkw5kIh065wMojn5oo2GMbiyYcMSxhIpYrceO/BTC5aOS702KOGWdeY5YFGyG4z13RAiKRPveS0beUWhd6zmmaWW4lvUk3SSG21aLG5opQxC3AGeWyDnn729SyrMFrqpo8yEeaPLNvnjo3591013Xm9bObts3WisXuZZFlWG4by9SiaPbNazLv23Aj6MCRIfkJ4Eq/uwyUlusvnyNNE01xGFtdRjjOWuonZRHNGRwWz5eG6FvJb95vaptKkutIh8y9MbLaoq3UJJP2+2+Ty5ouhyMR4kG0HbE3JVzW/p//ABO72G10mGS61BU22n7vzLnVbZwVaM7dvnM25lKqVkO6RCWMSg9UTz61eUF72q79Om7/AF6Lle6ZyWtfD+GxZriKaMapYwn/AEdPmt9Xsyv/AC0/iTandP3ixggiIwgjnrfQdW126TT7O3+x/wBnRm/06aRkSxa3ZyHSWV8RL8zEHzSF3F0+cSIa9P1rQ9O+G8CtqVzJqU9lcBrO2tJAZLYkbmguZSm1CrHPlqrEskwKxb91ec+O/G134usfsEiW9po8Uhlh0y2QpaRPjbu2kkvJtwvmuWkKqoZ22jHzOccPYetP6xQfs6nVrZ+q2fruetlGZ4msuWKU4dJS2X+FaN790rNxUrJGXqniLQfh3KYtLjGuajDcfbLW5mV1s9Mk2g/uVbDzkMI/mmCrmLBjcEk878b9WutZ+KviJrq4km8nUJ4IVY/LDEkjBI0HRUVeFUYVQAAABinR2duJ1hl3eSx28/Nt/r/Wr/xi8Iyr8SvEU6yRrby6pdlZTuaMsJHO0FQfmJG0AgcnkgZYfH1nXw/u4tJK/wAS+H531j/29p/eZ9lg8Ph4YuEqbcpuMtZfE9Y7W0+UUr7tXbZ59IQgLMQF7k8Yq9JojWC7tQkNizJuSApuupNyFkPl5GxDlPmkKkpIHRZQCtWH1ZdCuv8AiVJNbzQybkvpQFvAVcMjoAStuw2ofkLSKdwEzK2K2tM+J+naV8FrzwpH4P8ADjaleXPmnxC8TNqEcW5H8lMkog3IPmQBsMy52swaK1T2aj7OPtLtXs0kk9272bsu1nfa6PpsLBVub2k/ZpJtXTbbWy0TSv3elt7M5y71jMU1vZw/YbOYMjIH3zToWDBZZMAyfdTKgLGWQMI1OapUUVcpSk7smMIxVohRRRUlBRRRQB9jSQ1BPAzIyq3lsQQr4+4ex/CtGWMuxYksx5JPU1VvWaOBhk7Sd2M8Ejp/OvrpJWP5tp1G2Z/wZ+Pq+G9U0jT/ABBapJcaOiQTWN1GircBU2JglSr4wGAP3yFVVcEmvWvGmsap8SIptW0rVpfEKwofOt3hRL6wUHBVoAMbAeCYsrnPC4NfOXxAaHVI/KuYVl2Z2MRho8+h6j3HQ45BrE8L/EfVvAl7C0U1xdQ2xHlMspjubcAYGyQcjA4AwQAW2qhO6vCyzPMfkV6U4+3oPqtKkenzSXr1futs+uxnC+AzmSx2GtQxCWzV6cru7t1i2+z7J8ySPRfEHiO6kVj5yn0Oxf8ACsLRxca/qixtIMMeflX/AAroD8RtI+LllJNesq34UvJf28QjmAHVriEHaw9XU8DaN5YkVz8kN14F1VbiQJNa7sLcRHdG3se6n2YA/WvqKmeUswwsquXVebTbaS9VfT8V5m+W4GeErrD42lyS7aNP/C9n+D8j9Kf2XP8Aggfr/wAWfhVpXibxT4k0vwfFrlulzZWrWP266KOiuplUyQpExRlbaZCwDAMFcMi+Lf8ABSv/AIIw+JP2R/h7J4utdS03xN4WjlSCe9tYvImsnc7UaWLLqI2fCB0kcBztbaSu7079lb/gvz4j+D3w303w74g0nS/FVvpFrHZWtxNO1rdmGMBUSZwHjmCKFALR7jtyzO3zVj/tJf8ABS/x5/wU81DS/hjoul6bpum61ewpHpdg58y/kT/V/aJ3IXyotu/AWNBt3vuKKy/yJlcvFJ8TJ4ya+r8/vfB7Pkvry2/e81vh5tNr3s2/36pLh2nlnPTVpped7+f2bemp+SPibSLqxv5FXd8p6ha6Twb+0Xqnh61h03xBbt4g0mFBDFvk8q8s4wCAsM2GwozjY6ugGdqqx3D9cPDX/BuxeeNNEWS48a2K6pIAPJtNFNxbu5JXCTS3ELMu4EZ8rseMjFfnn/wUI/YA179jnxzDperCyuoNQt/tmnX9k7Pb30O4qSNwVldSMMjAFTgjcjI7f0zHETatzarfX8z88jisszO2GqR5r3tdNPzcZaO/fle3kZnh+9sPiDYyXXh3UF1SJVLzweX5V5Zqd29pIMk+WolJMiFoxtUFwzBRH8UNa8L2nxJ0+bxdY3N9Yvo1sLaJZmjgFwZboIbgoPNMA53eURIOq5I2N87afFqHh3U47uzluLS6t3EkU0LGOSNhyGVhyCPUc17Xb/FLS/jl4XsLPxJDYzeKrZfKkvpRHa3E4DyFXQnFvOVVyWjn8oyFFCSF5GrenWk+up87mfDdXBV414uUqWqbi+WcE+t1ZWVtZKzXZ6i+IPiD4ytNf0W+kXRdB0OSYf2bd6Nar5DLvBkFq/MkW4Eb4VaMAuRIqF3zj+ONZtvGekN4o08LptxfTm31d1Xdtu2DOXIUHy0nVZHAjAG4Sx+WsaKzXPh94Q8ReDPijY+XcTatot1qlra6xFNEx2KZ1RY762kGY3DPhS4KiQZidmQOKfgHVfDuqaxL5Cron9pRGz1DS558Wd7CxBPkXEhJhkDiN0FxujVoQ7ykfuj0RqT7v7yadOhSftKEU+RLWC0abbcZxd3zaXu7q6TfIm0YvgvxFJ4Q1GS11aOWbRdWi8m8jh2OZI85EkTZ2mSNwGUhgCylGOxnU6ba7rPwp1m60l5rXUNPmKSyW8iebZahEyho5VVgGXdG2VkGyVFkOCjE42NM/Z28R6V8RIdDvFhs9IuryGKO/wBRDQWV0s2wxsmQXLvE6nbGpmVWbgbWxz/jLxJpt/oGk6Rpy3d1Fo/m7b+7CxyzJIQ/lrGpYRxo5kYLvbLSSP8ALvKL0RqVF1f3nV7fDYuulRtUjJJyttazcZeUtLW+Jpp7ROm8HavC2tw6l4XvotH1aPIk0rUXQ2t2rffjSV8I8TLuDRT4yuE3TM2K6Tx9ZN4Y+x6lZ6TNb/aoGWWyugxaKKNtkloQ4z5sHyAs25/LaCUJFtNeNR8Hd6V6tL8Z9d8L/DfwzptvNayxPZGWN7i1jmmtWS5u41McjKWUBGdQoO0biwUOqsvRGrPu/vPKzTLasK1Oph7Su+VqTa0s3ZySd0raXTer110mt9Jm0i1ttR1zVvsFuoE+nzSQCe71O1lBO37PuBZTuPzMyxn9+nmOQq1Q1L4t3CWUmnaDbnRNMYOpzIJ7yeN/vRyz7VLIehRFRCApZC2WPG3eo3GrX0t1d3E11dXDNLLNK5d5GJyWYnkknkk9alg+/wDpXRGrPu/vLjlcPjxFpPta0V8uve7vZ35VG9jYXxldRAfaGaZduwuAFk28cE4w68KNrhhgYGM5rP1dV1VGlhmSPby7iP8Adj3dOWjxxkrvTc4AKgVWvT8tZim4a/jW0877UzhYhCT5m48ADHOTnHHrXPi68/5n953UMLBe/DT8v6/4cpXaXVrqkMUw2szArwNrgnAII4KnsRwfepviL4vv/D3xX8TTWcwVZdUuvMidBJFMvmtw6Hhv5jsRXongz4cR20zS+JtlvHZypJd2kLpFHa7shftbkGK0b5GUKoNxmNk8klwT478SNVh1rxtrN7bsXt7y+nnjYjbuVnYg47cGvmMVWqR95Sd/U9LLMRSxeLcFFSUY2bt7rbaat91/S1uttGPVdH8cbUaWHRdT6CKdv9FmP+xL1jJ5+V/l5ADVma54bvPD19JBdQSQyLyUZcMB6+49xkVyWoNw1dN4L8fXmm6fHY3aJqulr921uGP7n/rk4+aM/T5eT8pr56Elz2pWg/T3H6pax9Yaf3G9T6uVGpSjzR95dn8S9G9/SX/gSWhXzRXVTeD7XxPC02hzSTyYLNZygLdJ64A+WUe6YPIyK5m5tZLSQq6ldpxn0I7ex9jXYq1pKnVXLJ7X2f8Aha0l8tV1SegqVaFRNwd7brZr1W6/J9GyOiiitjQM0UZwaKAPtiWIBjtyVzxkYNV7i2WWJvvbsjAxxjnP9P1rQlhKthhtI9R0qGSAkE4OBxnHFfZuJ/L8KhxviDwkt4dx6dyOuK4XXPCMlozfKSPpXsr2/mnbtyzHgDuay9S0NLlG+UVxVsKpao+hy/OJ0nZ7Hh02nyWVzHPDJNb3UTh0ljO1kYdGBBByPXgjAwRW9oXxOks1+z6pH+7YbPtEKDaw9HTgHPAyMHliRKxrpfEHgbcpZV4+lcdqvhyS2cjafTgda+ZxmSr2nt6DdOp/NH9V1/PzPvcBntOtT9jXSnDs+no90WPE3hX7ZaC80mZWjkJCiJi0UhxnC9w2MEocMARlFzS/A747a38CPiNpevabeT6XrGj3K3VrcKAxidTwcMCrr1BVgVYEqwIJBwrG5u/Dtw0llMYGcBXQgNFKAcgMpBUgHBwQQCBwCM1oXs+k+OYvJvI10u/P3XLfuZD0GHYnb2H7wkfeJlQYWsY55Ww79nmcNP54rR+q6fh6M+iw9GnOHLQlzx6xfxL/AOSR+lfhH/g4n1yz8HfY77wvoc14y4MlreTW8OeeRG3mMuSSWCyKDuboDivOtF0Xx/8A8Fl/jJdX15daPY6b4dtI0lkCPFp+jW7u5SKOMF5HklYSsCzMzeWQ0ioihfzf8ZeENW8FXTNIJJLdcN5qg8KehPcAjBBPByMFq94/YN/4KD+Jv2OPFtxqGgzWckOoxLb6hYX0ZltL5FJK71VlYMhJKujKy7mGSrure1RqUZr2lNpp9V1/4Pqe3w3k+WUcVGtUjotOt15K+2u6Vj76+Iv/AAbn3GmeC0vNN8bafdXV1CJLcXejfZrV9wBG6aG5uHj6gfNFnkcDIFfln+0D8C9U+DnxC1bw/qdlJY6rot3LZXcDEMYZY2KsNykqwyDhlJVhggkEE/pb4g/4OEPEWueF2sdJ8P6TZ3UyBN91f3F5AuMYIhygyuAVDFlBAyCBg8R8Bv8Agnj4l/b0S68f+IvENrp8XiW4vL0X13Gs9zqUiNI9xMU3xRxpvjlG5nUAox2rGAx87Ms4w+X0fa4qSSvb/JW1d/8Ahz9P/wBX6ebzWHymHNNJt2ukorq3J6W73sfAfwy+M+qfD/XdJuNQt5NYt9GkRrXM7W91bIvHlxXCgukZUuvlsHixI58ssc1Tuvh0ur2k194buzrVrCrSzW5j8q/tFUZZnhydyDDNviZ1VQC5jLbB+gX7W3/BFjVPg18Mr3xNoWu6b4p06xtJtQlMVqbZntomkWSWJt8iSbRE7lGZJAqn5NxCn899S8PXnh7WlltWmhmtpBJFJGSrIynKsCOQQQCCOnFa5Pn+FzCDnh5XS+X4PU/O+JuB8XkeI9pKPs5zXk4ySb7O2jcvhad3719jQ+EGoXF38WPBsc000sdrqtpHCjuWEKm5D7VHYbmZsDjLE9SawIR835V3vgX4h6afG+jaj4usbn7Rp19BdPqunxL9rlCSK7ebExVJ2bB+cskhZyzySYC1a174SWOq2K6hot3Y2scziNc3JbTZpCCxSO5kCmA4DkQ3YRwiA+ZIWGfoqeq0Pz+pmCw+Kf1mDgpKKvvG6cm9V631SaV20lqcDGMj6mur8T/8i14V/wCwY/8A6W3dc/qOi3nh/U5LO/tLmyu4GAlguImjkjOM4ZWAI4IOD610fisf8Ux4T99Kf/0uu66ommLnGUqUou6cv/bJGPCMH8qtW/J/GrnhXwZfeKBNJbxrFZ2uDc3k7CO3tgckbnPGTtbaoyzkYUMeK9Es/Deg/CyBJtQZZr7AZTdWwkll9RFaPwqHgiW7A3Ryh0gLJXRE8nH5nSoy9lH3p/yrV/Pt3e7trZo5Xw98Kb/xGbaS4E1nbXmTbKkDT3d/jORbwL88hwr4b5Y8oVaRTjN/VfFWg/Cu2kg05I7i9ZSrLa3QlklBH/La8TgIRuBitNu+OXa85ZKzPHfxW1DxGLqG3aWztbvAuMzNNdX+3GGuZ2+eVvlQ4+WMMu5Y0JNee6g2R/nmuDFyJwuX4jF2ljXaP8i/V9f80mmtg8b+N9Q8WmGO6kWO0tNwtbOBBHb2obG7Yi4A3bV3N95yMsWbJrj79ua1r9uaxb9utfKYyR99l9CFOKhTSSXRGTftkYq/oyfdrNvWyw+vJrtfCngC4NjFfalIuk6fIN0bzKTNcj/plF95h0+Y4XBzk149CLlUcui1beiS7tvRLzZ6uKrRp01zPfZbt+SS1b8kWtBid541jV2kZhsCAlie2Mc5+nNdZ4ua3/saSPWDDNrO0CHZ81wo44mI+XGOzZbntWSfEi6VA1vo0MmnxMNr3DtuvJx7uOEHT5Ux06mskDBwO/Yd64824nw6oSwmGiqnNo5Ne6vOKera6SdrPZPc8zD5XVqVo4iq+S2yXxPyb2SfVK91u1sUbnSc/NH8v+yen+f88VSZGjcqwww6j0rbcrEhZ2A29een1NZF7OtxdMy/dPA461z8O5hiazdKr70Ut+qeml+vz1PYr04pXRFRRRX1Ryn3RIhJOefUnvUa20lxIsMSSSvIfljRSzMQD0Uck4z0961p9NWzdvtRkhweLcYM/wDFw3aPlQCW+bDqyo61WurvNtJDHH9nhkwGVG/1q/KT5h6v8yI2CdisCVVc191yJay/r/L+tGfyfGrf4f6/z/rUpSWcNp/rpi82eFtmVhGfmGS/KsQQrBUyGDf6xGBFU57NljZ1IliUZLr/AAdPvDqvLAZPyk5ALYq40ahxuBK5+YA84quS0UgdGaN1+6ythl/EVHutWa/z/wCD+HyOynJ/1/X+fzM25tg67T93+VYmr+HUuRnb83XNdXI0VyuJF8mXJzIgAQjnqgHHUcrgAL91ic1TntPK2mRd0bH5WU8NjBIB9QCMg8jIyB0rGpRur9P63/q3Zs9DD4mUHoeW+IPBRjZtq/pXKalorw/Ky7lznB7H19vrXtd5YrKvK1zuveF4Z4mbbtIySSeMdv615WIwcZRa6H1uXZ5KLSkeaaZ4gvNEhW3IW8sVJ/0abOEz1KEYKk9TtIDYG4OOKztX+Gen+M8zeH5Gtb4nmxcfOx9FVQA/UD92A3BPkqBmuy8ReAJNIeQXW6GZcjyNv75Tlh84/wCWeCvIbD4KkKQc1yV9pZjJ3LjtmvlcTktbCz9pgpcj/lez+XT+rWP0HLeIIVdZu/8AeW/z6P8ArqcRBJf+F9UjjulkjbOVOdyuB3Ujg/0r7g/Ye/4K1+Lv2WfCKaDZzQ3mjKJRHBJLLBNarKS0qRSxspEcjMWZGDqSSQAS2fmGfxBHrVu1vr0H2+N+t0APtCdgWzxLj/b+bCgCSMcVz2v/AA3msLV77Sbhb7T1xuKscwZIADg8oTnA3fKTkK8mM1w1sThccvqeaw5Jee1+6fT1vbzP0DI+I8Vl8/rOCnra111XZp/k7n6HfFv/AIKr+LP2odDuPC9pb2+n2utR/Y7owvLd3t3G42tAHYn5HB2lVTcwO3OCQfpb4Pf8G6GoeMvDNrdeLfGGm+H9YvojKdPttLfUvJ6A7pVlQZQnDYUpuztkcDJ/GL4c+M5vCuso8hkRo25BJVlP8wf1r9WPgH/wcX+N/B/g2Cy16x0PxFeQxrGb6QPbXF1jo04UmJ2/2lROPUkk/G8X5HneChSjwylGF252tzPa1nK6a3vdp7NXV0/neNuJM4zevCtWm5JadNF2S0SW/bXXun4n/wAFNP8Agkprn7ENnZ6lPdWWs+H9SuGs4NQt4zCyThGkEckRLbS6K7IUeRWWNjuHGfh/R7/VfBOrSTafNJbtIhhlXaGjnjJBMciMCskZKjKMCrYGQa/RD42/tk/EH/gq18QtJ8MyNYpaxSPNa6fbB0tYW27TcSsxeSSQIQgJzjdhEXewbeuP+CK7T6dtPiy1/tJo/PFv/Zv70pyCfI877Rw4Kf6rdnnbt5rqyXj55JhaeF4lqL6w9XZNtRbdnLlVk7b6JX2Pc4P8L89z/L5V401KF2rycUn1t7zSbta6R8G6L480fxnp8Wm6xawWewbY4pWf7KmSSTBLhpbRuWIUia3aSXc0caoK6zxL8J9I8PeHvC9/qBufsK6W/kHUiLeyP+m3bA+bCzvdLkhcWoyyOsm+IZFYX7Tn7PWpfs/+PbzQdWhSK8tcNlCdkqHoy5APUEYYAgqQRkV5fHuPBJr9oyrMqOPw0MTh3zRkk011TPy/iDg3E5djXhHUlScJPmju72adndNPVu+v3aHoviD4zGPyotDjkhFnu+z3c0KRPa5wW+zQITHaklUYuhaYuhbzvmIrjzM91I8kjtJJISzOxyzE8kk1TjHy/Ufzq0v3K9iBx0cFRw0eWkvn1f8AXZadkUr45FYuoNmte/asPU5Vj+ZmCjPBNeTjJHuYSOxlX7cmq2neF7zxLI32dUjhjP725mfy4Yf95v6DJ56VoH7PAfMuFaXPKxDgH69/5VM2tnUtkbsVWPiOIDbGg/2QOB/Ovz/NM+wlFuMXzy7Lb5v9Fd9NNz6bD4es17qt5v8ARf52XrsWtLsNJ8HlXsYV1TUl5+33cX7qE+sMJyMjjDPk5HAFR3t7NqV5JcXM0lxPIcvJI25m/Go8ZHoPU9Kr3+rQ6b95iz9hj5vy7fU18bisdisdJQe3SMdEvO3V+bbdt2elRwsKT595dW9/+AvJJLyLIT+98voMcn8KzNS8UQ2WY4f3sh4IU/KPq39B+lZOqa3caluXJjjbqqn731Pf+VVYbbd1r0MHkbetb7v83/l95pKqlsWX1Sa+k3SNn0A4Vfw/rVm3bIqCC1xVlE2CvscJR9nHlWiOOpK7HUUUV1mZ97zW/lEqV27eCCMYqF4G2FtrbQQN2OhOcD9DV2WPHNV5I8ivumj+SacykYWZwqjczHAA7k9qryxY4q7IlV3TjFZyR1wkUpoWC7tp25xnHBP+SKiXzA5EWd0mFKgBg/PAIPB59RweavR2Ul23yrwv3mPCoOpyfoCfwpbayE11HbWtu2oXkxCKoTcpY7cKq/xHO9eeDwRg0cr+Naf10OmNVLR/16mc2nxzwiaT/Q4mOecsJBl/uDO4/dK8/LuBy68Cqst0bOJfsqvb9R55P71zhc4b+AZBOFwcOVZnGK9Ov/2btV0kef4w8QeHfCM0uGMOq3TyXozz89vAks0Z5z+8ReuazX+E3g+VzGnxO0JZOzyabfCHP1EJbH/Ac+1TOWt46fh/w3yOOjn2DnrCTmu8ITnH/wACjFp/fp2R5PdaQtwu1Y+mcBR6c1y+u+EFlDFV5r3rU/2YNeuNJuNQ8OXmj+NLC1jMsz6Lc+dPDGOrvbMFuFQd2aMKO5615hdW/wA7Ky4b0I6Vw1KKe6PpspzyjWbeGqKXLuuqfaSeqfk0meSax4als23bWGeRx1rLtJrrRb4TWks1vPGDhoiVOCMHp2IyD6g85r1fUtGS5U/KPyrlNc8I43FV+leLjssp1o8tSN1/X3fI+/yzPJRd07M5e6TS/FYC3UcekX3RZ4Yj9lkP+1GozH9YgVAAAh6tWNrGiah4WuI1mVlSYFoZVcPFcAdSjqSrAE4OCcHg4ORWrqOjSW5Py/pTdO1240iOSDCXFncEGe1nXzIZiMgEqf4gCQHGHXJ2spr5uNHHZc74V88P5Jfp/wAD7mfbYfMKGIVqmj7rb+v60Ou/Z/8Ajzq3wZ8Y2msaXdta31qTtYgMrqwKsjKeGVgSCCPcYIBH2VH/AMFnPFTeDzY/YdFyygGP979lxjbs8nf/AKrH/LPdtPXrXwSdAs9aG/SpltZ+psLuYKpP/TKdsD1wkuCAAA8rHFZ7xXFndzW8qXEFxbttmgmQxzQt6Mh5BrjxGQ8P8R11UxdNKstLPR+l1bmW+nTVtK59zk/Hme5Dhnh8DVapt36NJ97NOz21XZa6HpXx5+OOpfGnxddavq1ybq8ucAttCrGijCoqjhVAwMDryTkkk8DHySaqxNv6+tWohxX6ZluX0cFQjhsPFRjFWSWiSWyR+d5xmWIx+JnisTJynJttvVtvdt9WWIx29wKtOdsJPQAZJPas+71KPT49zfMwPCg1h6nqE2sHEzfuc5EQ4X8R3/GuXOOJMHl0bVXefSK3+fZepw4PK62KleOke7/rUfq/ib7Q7R2CLM3QzPkQr9O7fhx71nQWO2XzppHuLg/8tH4x/ugcKPYVYAxx+AobEf3jj2z/ADPavyHNuIsXmE7SfLH+Vfr3PtMHgKWHjaC179Rklqt0NpXd9O1RiK301PMYgnpuJ6fT1/D9aivNY2grCAf/AEEf4/jWe6yXUm5iWPvUYLI6tX3qvur8f+B8/uNKmKjHRakmo69JPlYcoOm7Hzfh2FZwtmkPzc85Oe5rRi03NWPsYT/GvrcJlsKUeWCscMsU5PUyk08rzipY7faauSrtFV26/hXqRpRjsEZtgOBQx2rk8D1NWbPS5LuFpmKw2ycNK/C8hyAP7xPluAB1Ix1qUalHpZxYqRKp/wCPpx+8/gPyD+DlG5+8VkKnNdEaXu809F+fov8Ahl5kyqa8sdX+XqU54JLWdopY5I5UOGR1Ksp9weabVuDVM2629yn2i3QYTJ/eQ/fPyN2G6QsVPDELnpUy6Zpsqhv7WMO4Z8t7N2ZPYkHBI9RwaqNHn1g182l+bSf9aIl1eXSafyTf5Xa/rVn3nKq+Y21Sqk8AnPFQSIoQj5txIIOeMc9vy/Krt1D5TsrfLtOG9qG0phb+bcN9nhbBXK7pHBAIKpkcFSGDMVVgG2sSMV9vyvofyJColuZaQGa5jRY2laRwoRPvOScbR7np9abNZx2e77QzNIOPJRvmX7p+ZuinluMFgVIIXNdj8JrPwrrnxD0+x8Xalq/hvwrcGRb++0y1W+vwPLkKKqsyK29isZAKJtIZlYrzn/FSx0LQPiDrGm+H9WbxV4atLl49K1N4XtLi4t/l8ssrrlGCKqlGVlU7wnUOcPaQU/Z63te9nb7+/l+FtTvhTm6ftdLXta65vW19vP8AG+hyl/eNcxKpVUVWJCJxGOSRx14LNySThsdK9Y8H6r/woX9nK18WaSrR+KvF2o3GnW2pI2JdKtIUQS+Sesc0plA3jkIpAxuNeW3OlM0DTW7faYFySQu2WMDJy6ZJACjcWUsihlBYMdtdv8Kfibo0vge88C+L4bmTw7qVyL2zvbRQ1zo15t2ecqkgSRuuFeMkZAUghlGSXNfU8nPKLrYeCjFzhGadSC3lFXurdbO0nH7STjZ3s+T+D2n2/ib41+FrfVlgu7K81e2jvFu5zFDJE0q7/MkwxRCpO58HaMnBxiv1n+JH/BLr4HfEbTktYfBFlot5efZliutA1K8gkL3MgS2xLdfuiszAxxuLNbaSX92bqJyK/MWw+AXi7w94is9b+H+qQ+JJtPmjvNPv/Dd6Tf2siNujkWEbbmGRGAYNsUgrkHjNaVyn7R19M0bf8LflcltyE37dboXjZHvdYuD6zDzPv/NXzubZZisTUjPD1XC3rr9x9zw/xpkWHozhiHCV+knFONls1LWL7ppW7FP9rb9mPXP2Fvi7pLadrV1d6Xq1udU8P6zbq1lcSIsrxMsiZJguIZo3jkj3Eo6EAkFWOX+0yLX4jfC3wX8SPslvYa74kku9P1pLeEQw3tzbGM/a1QcBpFlXftAXepOAWNanir4eeKvFEtrcfF7x5NYWem+dLFa6lqZ1PVFMsjzzLFah2eN5JWeRjKYlZ3di24nPC/Hr4x2vxIn0XRtDsZtJ8K+G4TY6NYPJ508hc7nlkIA3zSt8xCgD7qgYUV6OHhVhRUa7vLv3/pbnz2KxGFzHOKGJymPuwbcprWPI4NezUvt3m4ySTfLy3k07J+a3Crxx2wSTwf8AP9KozwKx+Zc8Hocc11HjX4e634BkjTWNMutPMsksKNIA0bSwvsmi3qSvmRsQrx53oSoYLkZ52WIyNgc9/wAMf/WpyPsMLiKdWCqUpKUXs07r70c9q3h9LlT8tclrfhby/uqeOvv/AJ4r0OYZFUr6xEi/Mo+YZHv/AJxXHUw6kfQ4PHzpu1zyi6s3tmbqG7EdquW/iZbm1htNVt/t9rANkLb/AC7i1X0ilwSgGSQpDR5JPlk8jqdW8NLcBiq/dGT9P8muV1XQHgP3a+bzLJaVfWa16Nb/APBPs8tzprRP5Fh9CaaBrixkbVraNS7+XGEvLdQOS8WTvUYJLxlgAMvsJ21kTa/EIh9nVpGbne4wo+gzzTI5rjSblZI2aOSNldGU4KkcggjoR1z1FbVjr+g+JJpn8SWepfaPLbbeaZLHDO8nYzI6Mkw65I8uQlstI2MV42MzLO8JQdGNTmj/ADWvJL13+bu13PoKFHBV587Vn2vp/X9WOXkkaZ9zsWb1NJt+XJ+Udvf6Cln2QH5fm9M9QP8AGq8jSSHvz+tfLYXLMTi5c7vZ7t9f1b/q561TE0qSt+C/rQdNeLD8q9frz+JqlK0l0cHp6DpV630l5BnHtV+20YR9q+wy/JKdHVK77v8ATseRiMyctOnYxodL3nlauQ6asY/2v5Vqta+Rxjp2qGZcHP8ADx/n9K96GHUTg+sORXtobby5Fm8xGPMcicqh2twy9cFimWByoVsKxIFQ6rpkliiyfLJbSOyRTxndHIQA2M9mClSUYBgGGVGakmGCfoa7v4Q/Bc/EHwR4u1yHxz4I8NXHhm2+0S6Vrt55E+txKrTCO3jZGjuW8yFVERz+8aIkAfMCtiKNGnzVtFpqlfd2WnXV+XrYzrYiNCPtpuy0XV7tJbJta26W/M8yis5L6YxwxvJIFaQhf4UUFmY+iqASWPAAJPAzTnS00o/P5eoXCnGwMfs6coeWGC/SRSFwvKsHbpWle39vrWn/AGeLy9HAKt9mUsbS4ZPNKkuS0gkG4IhmMgzK58yCMbaxdT0+fTLrybiJopMB1BwQ6n7rqw4ZG6hlJVhyCRzW0lyxUoq/n0v2t/nvul1PRoy53yy08uv3/nZu3V9CO7vZr91aaRpGUYXgBVGcnAGAMnJ4AySTUdFFc7k27s7lFJWQUUUVIz9F5LiO0/49VbcORNIo3j733V5CcEc5ZgyAqy5K1mzFnkZmJZmYsxJyWJ5JJ9TV64+Z2YKFGcgDoPaqsu0Iy7RuyDu7gc8enPH5V+gybasfxvR01KUycmqsy81ekwrKxXcqnJB6H2qpMtYSPQpyKhZoJlkRmSSNgyspwykcgg9iPWmz3MN0rfaY2D4/10Cje3C/eQkK/Q85VizszM/AqSY5RflGc5z3PTj0/wD11Xb5HUldwB5B71PM0dkUnr/X9fgQ3dnNYp50ciyW+4IJ4WPlkksADkAqx2MQrhWKjdjBBMF1rV9LCIWvLlol6IZCVH4VLHcSWU3mRO0cmCpxyHU4yrA8Mp7qcg9wajne3u0G5VtJlGTIoZopeFHK8lD8rklQwJcALGorOST2/r+vP72dcI6+8r+dv6/D7kjLmbfIrSb5BkZ+bBI+pBx+X4VteHdb/sK7nfSLz7PJc2ZsLqC5sRc2+pwsgMsU0LGQOrshfGwrHsjIIkCOMq+tZLCbbNGvzBiuG3I4BK7lZThgGBGVJGVI9aoM7RTKysyOrBlZTgqRyCD2IPOaxkmnY7ZUo1ocr1Xyafyd0ev6H8WNN8Yah4lsfGFnZ6frHiq2isn1y+hWdPMQIkkqu0LrbMIIIYIpIoS/7x3nndljlj5f4o/ACPRfDepeKdFkbT/BljbiS3udY1i21SbU288QlY7jTonslm3Nn7KZ2kRIpZCxUHbyEnimZLRYpLe0uhCgWJJYkKJjJOFxwT04IGSzEF2LVueB/GfiD4bhZvDGopOtpfPeWjT6XBcpDdxpFsu4UmSWNbkR/IjSJvQOyoC7sozbT0Z48crr4OftMBJRu1eLcuRqKSsnZ8i5Ukrxmoq/JFHA6xpN1ot6bW+tbqyuQiSmG4haKQJIodG2sAdrKVZT0YEEZBBrPkGR9a9o8W/GTw/4kjvJPE2g+ZZ2d7qb6Z4Wiu9QN1ZPdskhubjU7uWSSMoQrCGBGimkWVpIYfM3PxfxG+C2ueCX0ea40HV9HXxRPImhaXqB8zV7yMEAM0SIpzlkUZjjMhZWSPac1m4n0WXZw58sMXB0pyva7j7zV21HW7aiuaVk4JPScrSa8/uU3Gs2+09Zl6CtaYgZ4ByMD2561RmGCtc8oprU+roya1Ryur+HAdxUfhXN6hozRH7tejXKK/YDgcCsy805JA2VB479q4a2FT1R7uFzCUdJHBR6Y8h5H6VoWegYxuFdF/ZaxdFoaJQThQOnA/KsY4VLVnoSx7lpEzY9PWFaZKgA6VclPyN+efSqsw+X8a25UloEJN6sqTdqpz8bau3Az7c9B2qrN0/Hr6VmzsplSX79U5kz1+tXJhzVW45ZuPXj86zPQplSYZP50WusSWNv9nZIrqz3mQ2twC0O4mMsy4IaNm8tAzxsjsq7SxUkFZuPz606PSNkKzXkn2O3cArlN80o+TlI8jI2uGDMUVgrAMWG2pgpfZ/4Hzvpb10ex1e5a0/l3+XW/psEelQ6u6rp0kn2hsAWdy6+a5w5xHIAqynCr8uEkZ5VREkwWqlc20lldTQTRyQz27tFLFIpR4nU4ZWU8hgQQQeQastrLW8LRWUf2GORSkjLJvuJlIdWVpcD5SsjKyIER1C71cqGpYtaMsEcN7H9uhjUJGS+y4hUbAFSXBIULGFVHDxoGcqisd1EvZvrr6af5/ckr6JW1NI+1T2vHt1/y+936t30KVFXJNJ8yFprST7ZDGN0g2bJoh85JePJ42xsxZWZVUruZSdtUwcis5QcdzaM1LY/Ra5j8t2U4ypI4ORVWeMlN3GAQOvOTnt17Vam+9+NVLj7lffPc/jemVmQyOqjGWIHJwOeKpy/4Vcm+7+X9Kqy9PwNZyPQplWZP3W75epA5/pVV03uqjA3HHJwO3erM/3D9T/Wq03T8azZ3UyrN3qrOuIw3HJI689v8atXA+X8aqz9Kxkd1MjivJIS0eFkhY72ikPyPgHn2OCwBGCMnB5qvLZx3a7rdtsmMtFIcdAuSrdCM7zg4ICjliadcdGqnPyKnm6M7acdbogvIGhl2spVuQVP3lPIOR1B9jVQhvMba2xmRlJDbSVKkMufQjIx3zitRtQE5WO7VplzgSA/vUG4k4P8XLMcHqcc8VQurBhD50TCaEAbmXrHwv3h1HLYz0JU4yKzlDrHX8zuoy6S/wCB/XkTxeI4Z7fZNDbwNCgaGSNTGY3BwDGY03xkZZsfPGWz+7Vm8xem+HnxoufhLJfaWuoTTaHrlxc3erfYY1mmvJ3t5IYZZSzoLpIpJHkNuzxxXKsyTErIVj4Gb+L8aqyDG6sbjr5Xh8RTdGqrxlut15NX2aeqfR2a1SPbvCnwz8M/H7wxFbjVLKz1bTje6rc32leErKyuo9Ot7bc0I03T5Vik3TGMCe5+zvvkWOL7UrN5PjXjz4T+JPhvZ6fNr2mw2P8AaVkupRLHf290y2xdY1ndYnZ4omkdVR5VQSE4Tdg4pW99NpWo2t5bt5d1YzJcW8m0MYpEIKsMgjIPNd/cftZeIrXwMulWCtpd5JMtxe31tcsH1O5USD7dcMR9onvXWWWOV57iWCaKTY1uAqkS2nuctHB5rga6WDcatKT1jK0ORXd3Fx2veN1yyWmkY3bfk0kZL7fUDpzXT+GPg/feK7RpYULbVLkD0HU/hXN3NyZbuSYrCjOxcrFEsUakknCogCqvoqgKBwAAAK9V+CH7Vmu/AwXEmg6ldaXcXEJgkeBsF0Jzg546gc9R2xWCtfU9zOauYQwvNl0VKp2baX32b/Bnk/i7wpN4avGhm+8Kwphg/l0/Cup+IXjJvFmpNN6nv3rlJD83+fasJH0OWyqulF1/i6lWQZRvpjr9arT1afn8qqy9qzZ7VMqzrt/PHB96p3I+T6H1q1J9wf571VufufjWR30itccfpTbfS5b9mZdiRxn55ZG2xp8yryfYuucZI3A9KdcdfyqeXWI9QghtdQ87yoMLFNAoMkI/dqcxkqsmERgBuRiWBMhChaVNRbtL5dNfXp/Wq3OrmkkuX5/8N1/rR7FGW8t9OT/RVM0xGPPlTGz5XB2J/CcMp3HLBowVIzis+WC41GeSRg8skjFmdjksT1Jq5c6VJBF526G4tsorTQMWRGbOFbIDITtfAdVLbSV3LyfoT9krwd8OvEl1InjjVtQ0bT/s7ss9jZLdyNLxtUqzrhTljkZ5AGBncvk51mTwVB1ZwbS1tFN39Ert+T1v3FisdDCUXXs5W3srv0stflb5HzI8TQnDrtNJXsHxD+FEPiLxFNHoYea3VjsYoEZlzwSoZgpx1AZgOmT1rz3xd8O77wdJtuo2X61zYXNsNWagpJSfTqezhpTq0VWs0mYcUjQyq6MyyIQVYHBU/WtBfFE20brXSZmx80kunxSSOfVmK5YnqSeSazc0V69OtOHwuwTpQn8Sufotcvudm2quSTgdBVWZx5ZXavzEHd3HXj9f0FWLj5XYblbbxkHINVZlyhbK8EDGeT1/Tj9RX3jP45pldn2OG2hsEHB6H61UlNWnG9lXKruOMtwB9fzqpK1Zy2PQpleZsxfdXqfm7n+n/wCuqztsdSVVgDnB6H61PMP3YbI5JGO/b/P51Xcb3Vcqu44yTwKykd1Mqz85qtO37tRtXrnd3PT/AD+NWJjmq1wMIvI5JGM/59f0NZSO6mVZG2scqG4IwfpVObpVyQb2+8o68k/59Kpy/erKR6FMrzt8y/KBgYJ9e+TVUTNby7lLK20qCGKkZGDggg9DVm4XA6ryCeOo69a98+HOv/BOD4VppuuWPh6bUL2TTbkC6fW7e6+0wWWqJdnUbmBJRFbme4hNummLukC2v2lcxStXFicQ6SUlFy9Ee5luDjiJOMpqKt9p2Pnaa4i1B/3oW3mY8yIv7tskklkHTr1TgBQAhJJqjeQtAI9yqquPldTuWToxwemQGGR1XgEA19OeE0+AviK6js10/QdNm1iz1WKC2vtY1WaGyuV8p9Ne/wBQlS0Cw7gyyrYxLI0UcpUyTzwW8TfFUn7Pnhjx/b6LNpOiXFra6aBql9pGr6zcWNxq2NVjMKzia4VtNWRtLk86CKWby43MTyMWSTllmibcZUpX9Ff89f6ep7VPI7RUlWhZ2W+l2l5ab7fkfLE7YHRTkd+3SqNwcj/gVfQvxJ8T/CP/AIVNqUPhTTfD+k6zeapCxt/N1bULxVi1G/YmG6uo0g+xm0kslTdHHdMY2E4JQyS6Px8b4J+INK8a+JNCsfDseo2ckn9mWuj3mpWtprFzqN1qOzNteS/aoxY2n2O4V4Yo7QzRNBIXSWESZvHNWvTlZu23pv6t6f5HZTyuPvWqxbST39b29EtdD5zHhHVb3wfqHiGHTbx9B0q5t7G81BIWNtazzrK0Mbv0VnWGUgE87DWE86M+zcpdhnGeQM9f6V+lX7Jf/BRT4N/DP9ke2tfEM2jeH/FOi6fFFceF9J8GWYfxLqNtM7x6kLldIkVZLi3FlDJ/p1nIj2TyRyRSuJ28D+FP7Tfwji/Yi03wD8QvC9p4k1fTb/V/Ec7R3GuWt1f6pcX+iwRXD/Zr6G0mnXSm1kRGVBHG1pbhsGacXPDHMcRzSUqL0klp2111srad+qPWjlOG5YuNdaxb176af126nyRL0/AVUnmQS7dyqzYwueT/AJwf1r9CvD9h+wz4y+Mn9j22h2sdnrXiXR7GzdvE/iax0+Gxm1AxvJBNdRhonWB4/tyag/lBElazu42ZTHX8J/GD9k3wl4I8aeCb+9aLS/EmjCC4h0G38RTeH31Q67o93E0K3c734sVttOtzeHzkupDb6glpKoks84zzaVtKM+nTo/Rvb9Duo5NC/vVo273/AOGPz1kb5G4HTr3HWqs3FXL1QJZtph25IHlFymMn7u/59vpu+bGM85qnMePxr0+hx01Z2KsxyOm3k8DtzVO5+4frVycYPrzjiqc4+X8azO6mVrjr+VVpjl/xP86sTGqs42ue+M9O9ZdDupkC3D2sm+NmjfayblOCVZdrL9CCQR3BIq3B4gl3/uZVtZmbO0sEiclh0PROpPOFAXr2qjNwfxqrIf5VF048slddv66nZGmpanuH7Ln7UM3wF8dafrn2Wwur7TJBPHDqdjHdwMShA3wygq3ytkEjKna6kMqsJvj78aP+GlviHeapJbaXZ3WrXBleOytYbG1RmIHyxoFjRfU8ZOWYkksfB0nZYhH96Nc7Vbouc9O45OeOCQM5qxZ6k9g+6Nm68AnkfX/GvkKnB+X/ANovOKUUq/Ly83Xlve3pfX11sfTZTmUKU4UsWuakndpdf8n950nxD+HMngm78iZrdpAof91Msq4PupOD7HB6HoRnkSMHrV7UPEE+oqFdqo4zX0WDp1YU0qzu+5rxJi8uxGNlVyum6dJ7Rbu0uzdlf1svQ/RCVv8AGqsrVe1RQmoTKoCqJGAAHTmqoRTpUjbRuE6AHHIG1/8AAflX6Qz+GqfcpTHLfSqsxq7aLv1C3VhuVpUBB7jcKo3PEh/3jWMjvp7leZvmqtMcGrtwoGnxtgbjMwJ7kYWq1mokv4VYBlaRQQe/NRI7YdyjKarTH5qsS8H8ajvFA0+NsDcXkBOOTgLj+dZPc7qZQmNVJTlq0LVRJdYYBhtk4I/2WrPbqfpWUjvp72KspyTVWY/L+Zq/fqFgtyABuRieOvzNVSFQ8vzAN+7c8/7prKx309ijIePxqrJz/WrEh/dVHfKFjh4+9Fk+/wAzVB3U9yjcNzVOVyvy8FeTg9vpWgVDJcZGdseR7crWbKfn/Csuh30yGb+tVZjx+lXNQXa64GPkU/8AjtViuVm46Jke3zCspHbTKVxyaqy9D/n1qxOefzqO+XbKcDHyjp/uispHoUijKeD9RVWbkVccZt5T3DLg+nWqc33f8+tZs9Cn/X4FWb7oqpOeV/Ort6Nt04HQMcCqrjMDfUf1rJndTKc336qTHOfpVmc8/j/Wq92MTyf7x/nWXQ9CmVZeG/OqkvA/Crc4/df8CNVG5k/EfzrNrod1MZRQKP4B9T/SszoCilXl1+opB0oA/9k=">
 </div>

<div class="lampe_container">
<img src="data:image/png;base64,iVBORw0KGgoAAAANSUhEUgAAADAAAAAwCAYAAABXAvmHAAAACXBIWXMAAAsTAAALEwEAmpwYAAAEB0lEQVR4nO1YW28bRRgd6BviNwBCfYaChISKKnhAPHNRxUMi0apQSExVApRCQ3FSUJO49JIUibaOQEIFKgcJMutAeGguDk5Jm2vrtkkqIKl3nDihSkvceHdnvAetjd01ibE37CYL8pE+yxpZ+s4Zn/PN7BJSRhlllPG/wXey+ojEeD1loluS+VUq84RR6e9MdEmM1xm/IW4CgLuCMf68QVJiAqUUlfkVifHn1ps7+XYGD1AmwqUSX1ay6KMM960L+aCsbZZkPmsmdDYucOlmCr8ldEzf1jH5h45zv6eKiODzUpQ/tabkJaZtoYwrWRJdcYGZpA4zlBTwa0JH/3yquKUYV9qZ9sSakA/GcL8k83i2+YUbKQg9n/jFhRQ6YlbtxOeDs3jQ8cCaPW+Q103kr9/W0TmzyjwwI9wi5KgAGuMv5Pw+K/J23vD7qsPM8uz0rGO7bx6Vc8od9kZg7SAvZax02REBlKmPZpv0zqVy5BdU3brfi1VUfdh2AcYJm21wbTGz+8ZnT7z4lFlFFry2C8hcBTINFjQ9F1q7yUuZOuuAAD6ZbaD95aDQXP7ufzPN4Q0rqO1T0DbNc+ttU6b1qTvrUsHi47YLkGS+mG1gIMGxrPHXv3C81rmElzuWUP1jEsfHVBwbVVHVmUyvVf2QTP+mhCAv2i7AfPImBdLXhZWa+69oeKUjIyKvvl9C61WtRAvxJfsFyHwm28C4NgzeKBzepkF1mYDDw2rpIWY85oAA0Ws+gY2DrLAFBPb1KTny+39SQK1MISa6bBcgMX7IyiQJTPGcACPc1qYQ99kugMa0J62Ow6wA62NU2+LMRS79JOWsAMr4pBe4mzgBKovtTgsIxsRO4hSMnaFMDDglgDIxEgA2ECfRfh0bKeM37RZAGU86colbCUGZP20+2P61AJkL480GWUtQxp8p9k+UIoAyrlBZvEjWA+1R9SHz87FVAVTmc+1R7XHigrdxqlUBlHHNNW/pJMaPWBYg8xbiFpgfN0sWENMeI24BZbjn8zOTsFKBOO4lbsJKJE+dHkezP4KmT8ZQ9/Ew9n54Hrtqz2FHTQjEbTjYPIb3m4bwVt0AqvaGsW13CJWenoJF3IbKFUhu3x1C9bv9eNM7gNqGQXx0bBRHTlzCiS/G3Sdgz4EBeH1DaDw+hpbWy/CfHv/HDBC34bMzE7dKzcDOPWFB3IZDn0a6ahsuoOaDn/HqO2G8tKu3oP9f39cfJW5DY/Pw5h01oVReBt4IwfNeP96uP4/9viE0tIzi6MnILd+pyCbiRnh9I5vqD4+Ej56MJPxfTuTZqfUrw2ITbf7AtY3E7aj09Bz4u20qPN115L+CrVsDGyqquxsrPN1xoyo9PQ3G2nrzKoM4gD8BpsmFeOMbZgoAAAAASUVORK5CYII=" />
  <br>
    <div class="lampe">  <h4>Cuisine</h4><label class="switch"><input type="checkbox" onchange="toggleCheckbox(this)" id="2" " %STATE2% "><span class="slider round"></span></label>  </div>
    <div class="lampe">  <h4>Chambre</h4><label class="switch"><input type="checkbox" onchange="toggleCheckbox(this)" id="4" " %STATE4% "><span class="slider round"></span></label>  </div>
     <div class="lampe"> <h4>Salon</h4><label class="switch"><input type="checkbox" onchange="toggleCheckbox(this)" id="33" " %STATE33% "><span class="slider round"></span></label> </div>
 </div>  
 <br>
 
 <div class="vent_container"> 
   <img src="data:image/png;base64,iVBORw0KGgoAAAANSUhEUgAAADAAAAAwCAYAAABXAvmHAAAACXBIWXMAAAsTAAALEwEAmpwYAAAEXElEQVR4nO1YT2wUVRifi2Ai3kzU4xRMSGpNeqkSS7ggNw8eJEuMxqMeKUY9EpISNWBiaAuVmrYRC+K/KJF2521bTSwtykFqKyidKfVi0JOd2c7se5t85Pd2p8xM3+zssrPbEvdLvkDg7czvN+/7/d73PU1rRStakUr8dIMeNZaKh5gpPjYs8TOz+D+GxTmy9HdxFf+XWy5msFbbKjF+m55kpjjNTJ5nlqCqsrT27MQtd9emAb/8J203THGMmdypGngkDeyOKd7Ds5oKfvomPcZM8eP9At9AxBRXppfpiaaAzy4VnmYW/ysIIGsK+uRXTp8t8KoAj85zemPcpW/+CK7nK3h2Q8HnTHo8CH7CFPT2lEcdQw7pA7bMV79bIyOBwP6xvFz73KhDn/8eJoF3NAT89DI9jK32X/blDU4vnC8BiWbvjBcL/v1ZL7S2a8Shr27eI2FYYqYhmpCCLb/kwiKXL1aBR+475yjBX14Syt8dOJ+XuxkgcbwBVllyG9Qttj4OvJ+nfilsINCTc2PXvzMV3DVeYCtuW2oEpM+XHw7xJYFHvvhFPgR+bJHT7sF44h1DDtwo6EyDqYCfXqAdhsXtoIP4IqyUbQM2jVzn6y5VzW+Gy+vLh52Dd9dNQLYHinr+YNajruHKpfTKt2uJpaMHcixiw4ZVPFg3AfQvcY4yviToSM6NLY1dp206MefJP5PAv35pTXXAnal/B2RjVtnX8eVCJdL3H3Uevk7dGUZ7D+Wo8/C8/Lc4x+qd8dRnhylmUyDA/63mdEWdYzeeOmNLwPte+j6UnT3zIX1A5KcUThVOfqduAtLSauhrTs4VaG+GbSCA3UApQRe+uFlicq9pBAAK4ACyO5NTEMhJcrV8DJYGgaQSQhmgHFAWfomgXFQlhPJCmaHcqiRwpyEihuAgPAhQ6SoQcc+8FPDzmVyp/gMihuBxsLEkAmmIWGWj6DiTbBFf+8OrhVgLhfUemXSlFccRSMVGMcMGH/rpb7yqQ+mtSVeuhy4qresaceShqCRgFV9OvZXA4JIEHm2239dA3EF9xOX+sbxsU1JvJRAYwIN+33E2voVAaURbAoi8ml17c8JNv5lD4PagdD1Sejha3zgQcBmVUyWB3zPqBEZM7mVvu7qWZuD2wAeE4QNDyIZ6HnZiRRnrWAM2PTvi0MXQaCl6tbTj2jV6KHgTgTEwOl3FiZGVbVcF/sCFPH3djJEyMNSv+C/DQO5PZxBuJU/H2fHapXuO9MyQQ+9OeZFDrYFDfeRaZZ0E6hbiCzlIhYTAMbgEpy9WBj95q9CuNfFi64fa+pqKuzPT8C+vvFq0xPFau9XIVy9AsBcXaJu2WYHbA3h2LXekOBjxm2zaVln/iV08iP6FmWIOzgK7RUqXMcUcbjfQHmT/pke0rR56xC61By30FoFNiJ19drvebx/V++1Fxalr6v2rH7X1rXZrDxBoisnNJbPz/kBvHTJ6/aCVqbUItKIV/7+4C2RoonHiRe+ZAAAAAElFTkSuQmCC">   
   <div class="ventilo_garage">  <h4>Ventilateur</h4><label class="switch"><input type="checkbox" onchange="toggleCheckbox(this)" id="25" " %STATE25% "><span class="slider round"></span></label> </div>
   </div>
   
    <div class="garage_container">
   <img src="data:image/png;base64,iVBORw0KGgoAAAANSUhEUgAAADAAAAAwCAYAAABXAvmHAAAACXBIWXMAAAsTAAALEwEAmpwYAAADAUlEQVR4nO1VUUgUURSdIIL6CCKinwiiIII+gsCIVcnVLHQ1CISo9L11N1cig+wjZef5wrDd3tNN7SNqoYIwIqwMJUT7Kgzyy6w+XGEtpbC2LEiKRLvxxizccbNxZmfWmgOHYXfe3nvOve/elSQbNmzY+CdRSvlWRHg7Irwbkfrt0mJBMQ2ux4RdQjKfwoTDNNl3LPNbHtqwSUpVFFedXY0IC2KZf/0tfDYRYRPCnKe6ca2UKiijdAWW+SlE+KdEwtVk48LsIdq00jLhlNKliNSXYcLe/L3wuI7ILCbMF1G6zFTxbj/LQTJ7tlDhKspsANewIkmCJUkVXkzYTiTzh4YJJ6qO9JaQc1nGC5eDW8QWSZZwrBp23o0o26ZbuJcG14mtgQmbNEs8/tUNPiWKdtjPN2gWfrAqsEpZiYR9MVs4Vs0H/yaK6K6uWzOvcLENxGZBhL+zXDhRcUzZWCcals8p3l3D3Yiw4RQQCn+8WoQNC60qA1YLwxppG2i954XPw1kAMYcujo9kwZ12r7kdaL5WqVt4PJuuVppjoPxMAMaGcpSkLa3luu/y9dajSqwP0Rzw1QaSb6Cru0RJGH3uglLKdBtw1zAY7C9QYnZ2oeQaOH3BD1Nv0xXSZr8h2wQTDqSRwORohqa4mg2Iag+9yFcqdb8TGyYe/6SovpbOzmtgsL9wzmGLRXeDrzZouAFfbQDeR6dnK56R/gLtBhJtCzF0dReroPHKSQjfOA4tt8uhrcMDXQ9KoOfRAejr3a8kfD2wF8ZHdsHEaAZ8fJmtfBbfi/finDjf1uFRfi/iiHg37/oS5jXMgFXEWg2IalktGmau0NPChQ/xTBDvsTzYsWefKTxSkZ+w8gs2IAI7z4fB1RsBZyhsuGhnXOykGHA9iUBB3yvlabQBV1zs5HQgFFYSZIcuG9+B0OzYhhsQ99KsGSiryDPeQKqsT2wbiC2yDkQep1n3B9aTpt9A5uaNKiY6q5eZGnL9PwZyHY5ZAXMd6UkzkKshl8qADRs2bEhW4AdtbiDRpKkEvwAAAABJRU5ErkJggg==">    
   <div class="ventilo_garage"> <h4>Garage</h4><label class="switch"><input type="checkbox" onchange="toggleCheckbox(this)" id="19" " %STATE19% "><span class="slider round"></span></label> </div>
</div>
     
      <div class="gaz_container"> 
   <img src="data:image/png;base64,iVBORw0KGgoAAAANSUhEUgAAADAAAAAwCAYAAABXAvmHAAAABmJLR0QA/wD/AP+gvaeTAAACwUlEQVRoge2ZT0hUQRzHP7O7YplRJOHaSiJSHipBM4rYzYugQpaHMkEsMiv6s+HJPNVNtkMYBGbiTSQhIvFit0AxgjqU6yVZtg7qQTSKjMX8Mx0216wVd+bNgzb3e/rt2/f9fX/fN/Nm3sxACilsbgirCaQPCfDiY64SrzJ/IlrAsLUaHFbI/wKS3oDLVKKqiQmlriDzo13PKlItsB5aH3SvecKB5ibLA0Y8JH0L2GYg0NwkQuEwoXDYtqcP/0ELaD8ZCQIf9UCPxRoaGKZXoDcqaRmQVaQzRx9Qo8OPg34yqRODzKsS9brQHI8wVzxAza+cylBuAenlKILXOmIJwCuGGVEhqLeAgyvKnEQhaFSlqBuQ+JQ5NubWeQc8GhzbcusYyEjkpi/pO6iufsZk5h7juX+HbRNZMOsgg3kVHKkd4WVumV0y9hloL/YDMJ2xm8rTA/TtP2uLji0G2ov9DOSfjP1eEk4ulncx5PEa1zJuoOvAJVqOt/11fcGRRmP5Y767thnVM2rgVc4xbpXdR4r48+On7Xn0FtaZlDRroK20hUXH6hqpwu2kwu1cc8+TwlqTkmZXZG+yS2OxZ6uDywVpAIx9lUxGlgEY37nPpKTZFog4t8Tic3uduAS4RDRewbe0TJOSZg0UzQZj8eFdjrjxodkxk5JmDdwc7YzFkaXV65HF1fh6sMukpFkDdeNP8b+PftZ3hBaY+SGZmZd0hBYAuDrWTf2HPpOSGusB38ZLv/6CUzwsusbb7BIASqbfcWO0kzOh5xsXpLhXaosBK1A1kPS7EpvSwJTxKlYgmFSlqBsQlveB1seyem71T4lZ7pAFSBqA2HLrzxOalROYBP+fQtDDZ+6qlqP3DkgEBo6nTEB9GD1BAMltO4pBcE8M0apC0dlWOa/MSTz3BVWKThfK0eAkCrcqIenngRRS2Oz4CXczn4zow60YAAAAAElFTkSuQmCC">
  <p> <span >Gaz: </span>  <span id="gazid">%GAZSTATE%</span>    </p>
  </div>









<script> function toggleCheckbox(element) {
  var xhr = new XMLHttpRequest();
  if(element.checked){ xhr.open("GET", "/update?output="+element.id+"&state=1", true); }
  else { xhr.open("GET", "/update?output="+element.id+"&state=0", true); }
  xhr.send();
} 





var chartH = new Highcharts.Chart({
  chart:{ renderTo:'chart-humidity' },
  title: { text: ' Humidity' },
  series: [{
    showInLegend: false,
    data: []
  }],
  plotOptions: {
    line: { animation: false,
      dataLabels: { enabled: true }
    }
  },
  xAxis: {
    type: 'datetime',
    dateTimeLabelFormats: { second: '%H:%M:%S' }
  },
  yAxis: {
    title: { text: 'Humidity (%)' }
  },
  credits: { enabled: false }
});







setInterval(function ( ) {
  var xhttp = new XMLHttpRequest();
  xhttp.onreadystatechange = function() {
    if (this.readyState == 4 && this.status == 200) {
      document.getElementById("humidity").innerHTML = this.responseText;


    var x = (new Date()).getTime(),
          y = parseFloat(this.responseText);
      //console.log(this.responseText);
      if(chartH.series[0].data.length > 40) {
        chartH.series[0].addPoint([x, y], true, true, true);
      } else {
        chartH.series[0].addPoint([x, y], true, false, true);
      }    
    }
  };
  xhttp.open("GET", "/humidity", true);
  xhttp.send();
}, 5000 ) ;






setInterval(function ( ) {
  var xhttp = new XMLHttpRequest();
  xhttp.onreadystatechange = function() {
    if (this.readyState == 4 && this.status == 200) {
      document.getElementById("gazid").innerHTML = this.responseText;
    }
  };
  xhttp.open("GET", "/gazstate", true);
  xhttp.send();
}, 1500 ) ;


</script>

<script>
var chartT = new Highcharts.Chart({
  chart:{ renderTo : 'chart-temperature' },
  title: { text: ' Temperature' },
  series: [{
    showInLegend: false,
    data: []
  }],
  plotOptions: {
    line: { animation: false,
      dataLabels: { enabled: true }
    },
    series: { color: '#059e8a' }
  },
  xAxis: { type: 'datetime',
    dateTimeLabelFormats: { second: '%H:%M:%S' }
  },
  yAxis: {
    title: { text: 'Temperature (Celsius)' }
    //title: { text: 'Temperature (Fahrenheit)' }
  },
  credits: { enabled: false }
});

setInterval(function ( ) {
  var xhttp = new XMLHttpRequest();
  xhttp.onreadystatechange = function() {
    if (this.readyState == 4 && this.status == 200) {
      document.getElementById("temperature").innerHTML = this.responseText;


    var x = (new Date()).getTime(),
          y = parseFloat(this.responseText);
      //console.log(this.responseText);
      if(chartT.series[0].data.length > 40) {
        chartT.series[0].addPoint([x, y], true, true, true);
      } else {
        chartT.series[0].addPoint([x, y], true, false, true);
      }    
    }
  };
  xhttp.open("GET", "/temperature", true);
  xhttp.send();
}, 5000 ) ;







</script>
</body>
</html>
)rawliteral";


//fonction qui renvoi l'etat du bouton
String outputState(int output){
  if(digitalRead(output)){
    return "checked";
  }
  else {
    return "";
  }
}


// fonction qui remplace les variables (placeholder) par ce qui convient 
String processor(const String& var){
 
if(var == "STATE2"){
    return outputState(2);}
 else if(var == "STATE4"){
    return outputState(4);}
 else if(var == "STATE33"){
    return outputState(33);}
 else if(var == "STATE25"){
    return outputState(25);}
     else if(var == "STATE19"){
    return outputState(19);}
    
else if(var == "TEMPERATURE"){
    return readDHTTemperature();
  }
  else if(var == "HUMIDITY"){
    return readDHTHumidity();
  }

else if(var == "GAZSTATE"){
    if(digitalRead (gaspin)){
      gazstate = "pas de fuite";
    }
    else{
      gazstate = "fuite gaz!!";
    }
    Serial.print(gazstate);
    return gazstate;
  }
  
  return String();
}









void setup(){
  // demarrer le port serie
  Serial.begin(115200);
  
//definir les input et output
  pinMode(cuisineLed, OUTPUT);
  digitalWrite(cuisineLed, LOW);
  pinMode(salonLed, OUTPUT);
  digitalWrite(salonLed, LOW);
  pinMode(chambreLed1, OUTPUT);
  digitalWrite(chambreLed1, LOW);
  pinMode(ventilopin, OUTPUT);
  digitalWrite(ventilopin, LOW);
  
//relier l'objet servo au pin
  servo.attach(garagepin);
  servo.write(0);
  delay(2000);

 pinMode(buzzerpin, OUTPUT);
 pinMode(Ledrouge, OUTPUT);
  pinMode(gaspin, INPUT);
//demarrer  le capteur dht 
 dht.begin();






// creer le point d'access avec les infos definies en haut 
  WiFi.mode(WIFI_AP);
  Serial.print("Setting AP (Access Point)…");
  // Remove the password parameter, if you want the AP (Access Point) to be open
  WiFi.softAP(ssid, password);

  IPAddress IP = WiFi.softAPIP();
  Serial.print("AP IP address: ");
  Serial.println(IP);
  

  // Demarrer le seveur 
  server.begin();


 
    //*******************************
    // pour ne pas encombrer la boucle void loop (), on utilise des Routes
    //les routes c'es comme des fonctions, qui indiquent quoi faire lorqsque une requete arrive:   192.168.4.1/.....
    
  // route pour la page web / 
  server.on("/", HTTP_GET, [](AsyncWebServerRequest *request){
    request->send_P(200, "text/html", index_html, processor);//  renvoie : index_html, avec la fonction processor pour remplacer les placeholders
  });




// route pour /temperature 
server.on("/temperature", HTTP_GET, [](AsyncWebServerRequest *request){

     HTTPClient http;                                                            //creer un client http
    float t = dht.readTemperature();                                        // lie la temperature, et l'enrengiste dans la variable t
  String serverPath = serverName + "insert_temp.php?temperature=" +t;      //lien vers la base de données, et la table des temperatures
      http.begin(serverPath.c_str());                  //envoie la temperature sur la base de donnés  
      int httpResponseCode = http.GET();      //reponse du serveur de base de donné
      
      if (httpResponseCode>0) {       //   si reponse = 200 Ok
        Serial.print("HTTP Response code: ");
        Serial.println(httpResponseCode);
        String payload = http.getString();
        Serial.println(payload);
      }
      else {
        Serial.print("Error code: ");
        Serial.println(httpResponseCode);
      }
      // Free resources
      http.end();
 request->send_P(200, "text/plain", readDHTTemperature().c_str()); //renvoie reponse 200 ok, et la temperature , en plain text
  });





  // route pour /humidity
  server.on("/humidity", HTTP_GET, [](AsyncWebServerRequest *request){
         HTTPClient http;                                              //creer un client http
    float  h = dht.readHumidity();                                      // lie l'humidite, et l'enrengiste dans la variable h
  String serverPath = serverName + "insert_humd.php?humidity=" +h;   //lien vers la base de données, et la table de l'humidite
      http.begin(serverPath.c_str());                                 //envoie la temperature sur la base de donnés 
      int httpResponseCode = http.GET();     //reponse du serveur de base de donné
      
      if (httpResponseCode>0) {                //   si reponse = 200 Ok
        Serial.print("HTTP Response code: ");
        Serial.println(httpResponseCode);
        String payload = http.getString();
        Serial.println(payload);
      }
      else {
        Serial.print("Error code: ");
        Serial.println(httpResponseCode);
      }
      // Free resources
      http.end();    
    request->send_P(200, "text/plain", readDHTHumidity().c_str());   //renvoiereponse 200 ok, et  l'humidite , en plain text
  });






  

  // route pour la requete GET / update envoyée par la fonction javascript des boutons :  ..../update?output=<inputMessage1>&state=<inputMessage2>
  server.on("/update", HTTP_GET, [] (AsyncWebServerRequest *request) {
    String inputMessage1;
    String inputMessage2;
    // GET input1 value on <ESP_IP>/update?output=<inputMessage1>&state=<inputMessage2>
    if (request->hasParam(PARAM_INPUT_1) && request->hasParam(PARAM_INPUT_2)) {
      inputMessage1 = request->getParam(PARAM_INPUT_1)->value();                  //lire l'id du bouton appuié
      inputMessage2 = request->getParam(PARAM_INPUT_2)->value();                   //lire l'etat du bouton appuié

       if (inputMessage1.toInt()==19) {                                                   // si le bouton du garage qui est appuié :
            if (inputMessage2.toInt()==1){   servo.write(90);   delay(400);     }         //ouvrir la porte 90 degres si l'etat du bouton = 1 
              else if (inputMessage2.toInt()==0){   servo.write(0);   delay(400); }  }    // fermer laporte 0 degres si l'etat du bouton =0
       else { digitalWrite(inputMessage1.toInt(), inputMessage2.toInt());}               // si un autre bouton est appuié, allumer ou eteindre selon l'etat 
    }
    else {
      inputMessage1 = "No message sent";            // erreur en cas de non envoi
      inputMessage2 = "No message sent";}
    Serial.print("GPIO: ");
    Serial.print(inputMessage1);
    Serial.print(" - Set to: ");
    Serial.println(inputMessage2);

// definir l'id et l'etat à envoyer à la base de données
String id ;
String etat ;
 if (inputMessage1.toInt()==2) {  id="cuisine";}
else if (inputMessage1.toInt()==4) { id="salon";}
else if (inputMessage1.toInt()==33) { id="chambre";}
else if (inputMessage1.toInt()==25) { id="ventilo";}
else if (inputMessage1.toInt()==19) { id="garage";}

 if (inputMessage2.toInt()==1) { etat="on";}
 else if (inputMessage2.toInt()==0) { etat="off";}

Serial.print(" etat ===== : ");
    Serial.println(etat);



 HTTPClient http;                                                                 //creer un client http
  String serverPath = serverName + "insert_states.php?id="+id+ "&state=" +etat;  //lien vers la base de données, et la table des etat des boutons
      http.begin(serverPath.c_str());                                           // envoi l'id et l'etat à la base de données
       int httpResponseCode = http.GET();                                       //reponse du serveur de base de donné                        
      
      if (httpResponseCode>0) {                  //   si reponse = 200 Ok
        Serial.print("HTTP Response code: ");
        Serial.println(httpResponseCode);
        String payload = http.getString();
        Serial.println(payload);
      }
      else {
        Serial.print("Error code: ");
        Serial.println(httpResponseCode);
      }
      // Free resources
      http.end();
    
    request->send(200, "text/plain", "OK");  // renvoi la reponse 200 ok
  });




        // route lorseque  GET   /gazstate arrive  :  requete envoyé chaque 2 secondes par la fonction javascript
  server.on("/gazstate", HTTP_GET, [](AsyncWebServerRequest *request){

     if(digitalRead (gaspin)){ }    // ne rien faire si le capteur renvoi 1 (pas de fuite )    
     else {String id="gaz" ;        // si le capteur envoir 0 (fuite), definir l'id et l'etat à envoyer sur la base de données
      String etat="fuite"; ;
 
 HTTPClient http;                                                                //creer un client http
  String serverPath = serverName + "insert_states.php?id="+id+ "&state=" +etat;   //lien vers la base de données, et la table des etat des boutons (et du gaz)
      http.begin(serverPath.c_str());                                          // envoi l'id et l'etat à la base de données
      int httpResponseCode = http.GET();                                   //reponse du serveur de base de donné
      
      if (httpResponseCode>0) {               //   si reponse = 200 Ok
        Serial.print("HTTP Response code: ");
        Serial.println(httpResponseCode);
        String payload = http.getString();
        Serial.println(payload);
      }
      else {
        Serial.print("Error code: ");
        Serial.println(httpResponseCode);
      }
      // Free resources
      http.end();
      }
     
       
      request->send_P(200, "text/plain", readgazState().c_str());  // renve reponse 200 ok , avec l'etat du gaz en plain text
    
  });
  
}





void loop() {
  //en cas de fuite de gaz, declancher l'alarme (buzzer+LEDrouge) pendant 4 secondes
  int value = digitalRead (gaspin);
    if (value == 0 ){
       for (int i=0 ; i<4 ; i++){
      Serial.println(" boucle Alerte ! ");
      gazstate = "fuite gaz!!";
       digitalWrite(buzzerpin, HIGH); 
       digitalWrite(Ledrouge, HIGH); 
     delay(500);
    digitalWrite(buzzerpin, LOW);
    digitalWrite(Ledrouge, LOW); 
    delay(500);} }
}
 

